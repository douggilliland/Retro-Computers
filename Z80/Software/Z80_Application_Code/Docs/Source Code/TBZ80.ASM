;	PALO ALTO TINY BASIC
;	PORTABLE Z80 VERSION
;	W/BDOSZ80 VERSION 1.03
;
PCTCC2	EQU	12H
PSIOBD	EQU	1AH
PSIOBC	EQU	1BH
;
;	RESET
	ORG	0000H
	JP	SYSINI
;
;	BDOSZ80
	ORG	0005H
BDOSZ80:
	LD	B,00H
	LD	HL,JMPTBL
	ADD	HL,BC
	ADD	HL,BC
	ADD	HL,BC
	JP	(HL)
JMPTBL:	JP	SYSINI
	JP	RBUFRD
	JP	SIOBWT
	JP	RBUFRD
	JP	SIOBWT
	JP	SIOBWT
	JP	DCONIO
;
;	SIOB -> BUFFER
	ORG (($-1) AND 0FFFEH) + 2
INTVCT	DW	INTRCV
INTRCV:
	PUSH	AF
	PUSH	BC
	PUSH	DE
	PUSH	HL
SIOBRD:	IN	A,(PSIOBC)
	BIT	0,A
	JR	Z,RWTEXT
	IN	A,(PSIOBD)
	CP	11H
	JR	Z,STRWT1
	CP	13H
	JR	NZ,STRWT2
STRWT1:	LD	(XFLAGS),A
	JR	RWTEXT
STRWT2:	LD	D,A
	LD	A,(RBFCNT)
	CP	0FFH
	JR	Z,RWTEXT
	CP	0FFH-80
	JR	NZ,STRWT3
	LD	E,13H
	CALL	SIOBDW
STRWT3:	INC	A
	LD	(RBFCNT),A
	LD	A,(RBFWTP)
	LD	C,A
	LD	B,00H
	LD	HL,RECBUF
	ADD	HL,BC
	LD	(HL),D
	INC	A
	LD	(RBFWTP),A
RWTEXT:	POP	HL
	POP	DE
	POP	BC
	POP	AF
	EI
	RETI
;
;	BUFER -> A
RBUFRD:
	PUSH	BC
	PUSH	DE
	PUSH	HL
LOPRBR:	LD	A,(RBFCNT)
	CP	00H
	JR	Z,LOPRBR
	DI
	CP	0FFH-80
	JR	NZ,STRRD1
	LD	E,11H
	CALL	SIOBDW
STRRD1:	DEC	A
	LD	(RBFCNT),A
	LD	A,(RBFRDP)
	LD	C,A
	LD	B,00H
	LD	HL,RECBUF
	ADD	HL,BC
	LD	D,(HL)
	INC	A
	LD	(RBFRDP),A
	LD	A,D
	EI
	POP	HL
	POP	DE
	POP	BC
	RET
;
;	E -> SIOB DIRECT
SIOBDW:
	PUSH	AF
SIOBD1:	IN	A,(PSIOBC)
	BIT	2,A
	JR	Z,SIOBD1
	LD	A,E
	OUT	(PSIOBD),A
	POP	AF
	RET
;
;	E -> SIOB
SIOBWT:
	PUSH	AF
UWLOP1:	LD	A,(XFLAGS)
	CP	13H
	JR	Z,UWLOP1
UWLOP2:	POP	AF
	DI
	CALL	SIOBDW
	EI
	RET
;
;	DIRECT I/O
DCONIO:
	PUSH	AF
	LD	A,E
	CP	0FFH
	JR	Z,DCONIN
	JP	UWLOP1
DCONIN:	POP	AF
	LD	A,(RBFCNT)
	CP	00H
	RET	Z
	JP	RBUFRD
;
;	SIO COMMAND CHAIN
SIOCMD:
	DB	00011000B
	DB	02H,INTVCT AND 00FFH
	DB	01H,00011000B
	DB	04H,01000100B
	DB	05H,11101010B
	DB	03H,11000001B
SIOCML	EQU	$-SIOCMD
;
;	SYSTEM INITIALIZE
SYSINI:
	DI
	LD	HL,8000H
	LD	(HL),00H
	LD	DE,8001H
	LD	BC,7FFFH
	LDIR
;
	LD	SP,0FEFCH
	LD	HL,INTVCT
	LD	A,H
	LD	I,A
	IM	2
;
	LD	A,11H
	LD	(XFLAGS),A
;
	LD	A,00000111B
	OUT	(PCTCC2),A
	LD	A,4 ;9.8304MHz
;	LD	A,3 ;7.3728MHz
;	LD	A,1 ;2.4576MHz
	OUT	(PCTCC2),A
;
	LD	B,SIOCML
	LD	C,PSIOBC
	LD	HL,SIOCMD
	OTIR
;
	EI
;
;	PALO ALTO TINY BASIC
;
	OPT EXP
ITOP	EQU	0100H
LTOP	EQU	8000H
VTOP	EQU	0F000H
;
LBUF	EQU	VTOP+0037H
LBFSZ	EQU	80
MSTK	EQU	LBUF+LBFSZ
TMSTK	EQU	MSTK+30
;
PROMPT	EQU	'>'
RUBOUT	EQU	7FH
BS	EQU	08H
ESC	EQU	1BH
;
MTST	MACRO
	CALL	TEST
	DB	&1
	DB	&2-$-1
	ENDM
CASE	MACRO
	DB	'&1'
	DB	(&2 SHR 8)+80H
	DB	&2 AND 0FFH
	ENDM
MENDC	MACRO
	DB	(&1 + 8000H) SHR 8
	DB	&1 AND 0FFH
	ENDM
;
	ORG	ITOP
ENTRY:
	LD	HL,OTOP
	LD	(OBTM),HL
	CALL	CRLF
	LD	DE,OPNMS1
	SUB	A
	CALL	MSG
	LD	DE,OPNMS2
	SUB	A
	CALL	MSG
	LD	DE,OPNMS3
	SUB	A
	CALL	MSG
;
START:
	CALL	CRLF
	LD	DE,OKMES
	SUB	A
	CALL	MSG
	LD	HL,$+7
	LD	(CLABL),HL
	LD	HL,0000H
	LD	(FCNTR),HL
	LD	(RSTCK),HL
;
EDITR:	LD	A,PROMPT
	CALL	GETL
	PUSH	DE
	LD	DE,LBUF
	CALL	GINT
	CALL	SKPBL
	LD	A,H
	OR	L
	POP	BC
	JP	Z,KWCPR
INSRT:	DEC	DE
	LD	A,H
	LD	(DE),A
	DEC	DE
	LD	A,L
	LD	(DE),A
	PUSH	BC
	PUSH	DE
	LD	A,C
	SUB	E
	PUSH	AF
	CALL	SRCH
	PUSH	DE
	JP	NZ,MOVE
	PUSH	DE
	CALL	SKIPL
	POP	BC
	LD	HL,(OBTM)
	CALL	TRNSF
	LD	H,B
	LD	L,C
	LD	(OBTM),HL
MOVE:	POP	BC
	LD	HL,(OBTM)
	POP	AF
	PUSH	HL
	CP	03H
	JP	Z,START
	ADD	A,L
	LD	L,A
	LD	A,00H
	ADC	A,H
	LD	H,A
	LD	DE,VTOP
	CALL	COMPR
	JP	NC,ERSRY
	LD	(OBTM),HL
	POP	DE
	CALL	TR2
	POP	DE
	POP	HL
	CALL	TRNSF
	JP	EDITR
;
GETL:	CALL	PUT
	LD	DE,LBUF
GETL1:	CALL	GET
	JP	Z,GETL1
	CP	0AH
	JP	Z,GETL1
	OR	A
	JP	Z,GETL1
	CP	BS
	JP	Z,CRUB
	CP	'X'-'@'
	JP	Z,CCAN
	CALL	PUT
	LD	(DE),A
	INC	DE
	CP	0DH
	RET	Z
	LD	A,E
	CP	LBUFL + LBFSZ
	JP	NZ,GETL1
CRUB:	LD	A,E
	CP	LBUFL
	JP	Z,GETL1
	DEC	DE
	LD	A,BS
	CALL	PUT
	JP	GETL1
CCAN:	CALL	CRLF
	LD	A,'@'
	JP	GETL
LBUFL	EQU	LBUF AND 0FFH
;
SRCH:	LD	A,H
	OR	A
	JP	M,ERHOW
	LD	DE,OTOP
SRCH1:	PUSH	HL
	LD	HL,(OBTM)
	DEC	HL
	CALL	COMPR
	POP	HL
	RET	C
	LD	A,(DE)
	SUB	L
	LD	B,A
	INC	DE
	LD	A,(DE)
	SBC	A,H
	JP	C,SKPL1
	DEC	DE
	OR	B
	RET
;
SKIPL:	INC	DE
SKPL1:	INC	DE
SKPL2:	LD	A,(DE)
	CP	0DH
	JP	NZ,SKPL1
	INC	DE
	JP	SRCH1
;
TRNSF:	CALL	COMPR
	RET	Z
	LD	A,(DE)
	LD	(BC),A
	INC	DE
	INC	BC
	JP	TRNSF
;
TR2:	LD	A,B
	SUB	D
	JP	NZ,TR2E
	LD	A,C
	SUB	E
	RET	Z
TR2E:	DEC	DE
	DEC	HL
	LD	A,(DE)
	LD	(HL),A
	JP	TR2
;
KWCPR:	LD	HL,CMDKW-1
;
NXTKW:	CALL	SKPBL
NXTK1:	PUSH	DE
KWC1:	LD	A,(DE)
	INC	DE
	CP	'.'
	JP	Z,KWSRT
	INC	HL
	CP	(HL)
	JP	Z,KWC1
	LD	A,7FH
	DEC	DE
	CP	(HL)
	JP	C,EXEQT
KWSK1:	INC	HL
	CP	(HL)
	JP	NC,KWSK1
	INC	HL
	POP	DE
	JP	NXTK1
;
KWSRT:	LD	A,7FH
KWSK2:	INC	HL
	CP	(HL)
	JP	NC,KWSK2
;
EXEQT:	LD	A,(HL)
	INC	HL
	LD	L,(HL)
	AND	7FH
	LD	H,A
	POP	AF
	JP	(HL)
;
TEST:	EX	(SP),HL
	CALL	SKPBL
	CP	(HL)
	INC	HL
	JP	Z,TSTEQ
	PUSH	BC
	LD	C,(HL)
	LD	B,00H
	ADD	HL,BC
	POP	BC
	DEC	DE
TSTEQ:	INC	DE
	INC	HL
	EX	(SP),HL
	RET
;
SKPBL:	LD	A,(DE)
	CP	' '
	RET	NZ
	INC	DE
	JP	SKPBL
;
CMDKW:	CASE	'LIST',LIST
	CASE	'RUN',RUN
	CASE	'NEW',NEW
STMKW:	CASE	'NEXT',NEXT
	CASE	'LET',LET
	CASE	'INPUT',INPUT
	CASE	'IF',IFSTM
	CASE	'GOTO',GOTO
	CASE	'GOSUB',GOSUB
	CASE	'RETURN',RETRN
	CASE	'REM',REM
	CASE	'FOR',FOR
	CASE	'PRINT',PRINT
	CASE	'STOP',STOP
	MENDC	LETDF
;
NEW:	CALL	TSCR2
	LD	HL,OTOP
	LD	(OBTM),HL
STOP:	CALL	TSCR2
	JP	START
;
GOSUB:	CALL	PSHV
	CALL	EEXPR
	PUSH	DE
	CALL	SRCH
	JP	NZ,ERHW1
	LD	HL,(CLABL)
	PUSH	HL
	LD	HL,(RSTCK)
	PUSH	HL
	LD	HL,0000H
	LD	(FCNTR),HL
	ADD	HL,SP
	LD	(RSTCK),HL
	JP	RUN2

RETRN:	CALL	TSCR2
	LD	HL,(RSTCK)
	LD	A,H
	OR	L
	JP	Z,ERWHT
	LD	SP,HL
	POP	HL
	LD	(RSTCK),HL
	POP	HL
	LD	(CLABL),HL
	POP	DE
	CALL	POPV
	JP	ENDL
;
FOR:	CALL	PSHV
	CALL	LTSUB
	DEC	HL
	LD	(FCNTR),HL
	LD	HL,KWTO-1
	JP	NXTKW
KWTO:	CASE	'TO',FORTO
	MENDC	ERWHT
;
FORTO:	CALL	EEXPR
	LD	(FTOV),HL
	LD	HL,KWSTP-1
	JP	NXTKW
KWSTP:	CASE	'STEP',FSTEP
	MENDC	FSTP1
;
FSTEP:	CALL	EEXPR
	JP	FOR0
FSTP1:	LD	HL,0001H
FOR0:	LD	(FSTPV),HL
	LD	HL,(CLABL)
	LD	(FLABL),HL
	EX	DE,HL
	LD	(FOBJ),HL
	LD	BC,000AH
	LD	HL,(FCNTR)
	EX	DE,HL
	LD	H,B
	LD	L,B
	ADD	HL,SP
	DB	3EH
FOR3:	ADD	HL,BC
	LD	A,(HL)
	INC	HL
	OR	(HL)
	JP	Z,FOR10
	LD	A,(HL)
	DEC	HL
	CP	D
	JP	NZ,FOR3
	LD	A,(HL)
	CP	E
	JP	NZ,FOR3
FOR5:	EX	DE,HL
	LD	HL,0000H
	ADD	HL,SP
	LD	B,H
	LD	C,L
	LD	HL,000AH
	ADD	HL,DE
	CALL	TR2
	LD	SP,HL
FOR10:	LD	HL,(FOBJ)
	EX	DE,HL
	JP	ENDL
;
NEXT:	CALL	TSTV
	JP	C,ERWHT
	LD	(NCNTR),HL
NEXT1:	PUSH	DE
	EX	DE,HL
	LD	HL,(FCNTR)
	LD	A,H
	OR	L
	JP	Z,ERWT1
	CALL	COMPR
	JP	Z,NEXT2
	POP	DE
	CALL	POPV
	LD	HL,(NCNTR)
	JP	NEXT1
NEXT2:	LD	E,(HL)
	INC	HL
	LD	D,(HL)
	LD	HL,(FSTPV)
	PUSH	HL
	ADD	HL,DE
	EX	DE,HL
	LD	HL,(FCNTR)
	LD	(HL),E
	INC	HL
	LD	(HL),D
	LD	HL,(FTOV)
	POP	AF
	OR	A
	JP	P,NEXT4
	EX	DE,HL
NEXT4:	CALL	CMINT
	POP	DE
	JP	C,NEXT5
	LD	HL,(FLABL)
	LD	(CLABL),HL
	LD	HL,(FOBJ)
	EX	DE,HL
	JP	ENDL
NEXT5:	CALL	POPV
	JP	ENDL
;
PSHV:	LD	HL,TMSTK
	CALL	TWSCP
	POP	BC
	ADD	HL,SP
	JP	NC,ERSRY
	LD	HL,(FCNTR)
	LD	A,H
	OR	L
	JP	Z,NPSH
	LD	HL,(FOBJ)
	PUSH	HL
	LD	HL,(FLABL)
	PUSH	HL
	LD	HL,(FTOV)
	PUSH	HL
	LD	HL,(FSTPV)
	PUSH	HL
	LD	HL,(FCNTR)
NPSH:	PUSH	HL
	PUSH	BC
	RET
;
POPV:	POP	BC
	POP	HL
	LD	(FCNTR),HL
	LD	A,H
	OR	L
	JP	Z,NPOP
	POP	HL
	LD	(FSTPV),HL
	POP	HL
	LD	(FTOV),HL
	POP	HL
	LD	(FLABL),HL
	POP	HL
	LD	(FOBJ),HL
NPOP:	PUSH	BC
	RET
;
IFSTM:	CALL	EEXPR
	LD	A,H
	OR	L
	JP	NZ,NXTGO
REM:	LD	HL,0000H
	CALL	SKPL2
	JP	NC,RUN2
	JP	START
;
LIST:	CALL	GINT
	CALL	TSCR2
	CALL	SRCH
LISTL:	JP	C,START
	CALL	WLINE
	CALL	BREAK
	CALL	SRCH1
	JP	LISTL
;
WLINE:	LD	A,(DE)
	LD	L,A
	INC	DE
	LD	A,(DE)
	LD	H,A
	INC	DE
	LD	C,04H
	CALL	WINT
	LD	A,' '
	CALL	PUT
	SUB	A
	CALL	MSG
	RET
;
PRINT:	LD	C,6
PRSC:	MTST	3BH,PRCR
	CALL	CRLF
	JP	NXTGO
PRCR:	MTST	0DH,PRSHA
	CALL	CRLF
	JP	RUN1
PRSHA:	MTST	23H,PRLTR
	CALL	EEXPR
	LD	C,L
	JP	PRCMA
PRLTR:	CALL	PRSUB
	JP	PREXP
PRCMA:	MTST	2CH,PREND
	CALL	TSTSC
	JP	PRSHA
PREND:	CALL	CRLF
	JP	ENDL
PREXP:	CALL	EEXPR
	PUSH	BC
	CALL	WINT
	POP	BC
	JP	PRCMA
;
PRSUB:	MTST	22H,PR13
	LD	A,22H
	JP	PR11
PR13:	MTST	27H,PR14
	LD	A,27H
PR11:	CALL	MSG
	CP	0DH
	POP	HL
	JP	Z,RUN1
	JP	PR12
PR14:	MTST	5FH,PR15
	LD	A,80H+0DH
	CALL	PUT
	CALL	PUT
	POP	HL
PR12:	INC	HL
	INC	HL
	INC	HL
	JP	(HL)
PR15:	RET
;
WINT:	PUSH	DE
	LD	DE,000AH
	PUSH	DE
	LD	B,D
	DEC	C
	CALL	ABS
	JP	P,WINT1
	LD	B,'-'
	DEC	C
WINT1:	PUSH	BC
WINT2:	CALL	DIVID
	LD	A,B
	OR	C
	JP	Z,WINT3
	EX	(SP),HL
	DEC	L
	PUSH	HL
	LD	H,B
	LD	L,C
	JP	WINT2
WINT3:	POP	BC
WINT4:	DEC	C
	LD	A,C
	OR	A
	JP	M,WINT5
	LD	A,' '
	CALL	PUT
	JP	WINT4
WINT5:	LD	A,B
	CALL	PUT
	LD	E,L
WINT6:	LD	A,E
	CP	0AH
	POP	DE
	RET	Z
	ADD	A,30H
	CALL	PUT
	JP	WINT6
;
ERRIN:	LD	HL,(NCNTR)
	LD	SP,HL
	POP	HL
	LD	(CLABL),HL
	POP	DE
	POP	DE
INPUT:	PUSH	DE
	CALL	PRSUB
	JP	INPT2
INPT1:	CALL	TSTV
	JP	C,INPT6
	JP	INPT4
INPT2:	PUSH	DE
	CALL	TSTV
	JP	C,ERWHT
	LD	A,(DE)
	LD	C,A
	SUB	A
	LD	(DE),A
	POP	DE
	CALL	MSG
	LD	A,C
	DEC	DE
	LD	(DE),A
INPT4:	PUSH	DE
	EX	DE,HL
	LD	HL,(CLABL)
	PUSH	HL
	LD	HL,INPUT
	LD	(CLABL),HL
	LD	HL,0000H
	ADD	HL,SP
	LD	(NCNTR),HL
	PUSH	DE
	LD	A,':'
	CALL	GETL
	LD	DE,LBUF
	CALL	EEXPR
	POP	DE
	EX	DE,HL
	LD	(HL),E
	INC	HL
	LD	(HL),D
	POP	HL
	LD	(CLABL),HL
	POP	DE
INPT6:	POP	AF
	MTST	2CH,ENDL
	JP	INPUT
;
LETDF:	CALL	TSCR1
	CP	0DH
	JP	Z,ENDL
LET:	CALL	LTSUB
	MTST	2CH,ENDL
	JP	LET
;
LTSUB:	CALL	TSTV
	JP	C,ERWHT
	PUSH	HL
	MTST	3DH,LERR
	CALL	EEXPR
	LD	B,H
	LD	C,L
	POP	HL
	LD	(HL),C
	INC	HL
	LD	(HL),B
	RET
;
GOTO:	CALL	EEXPR
	PUSH	DE
	CALL	TSCR2
	CALL	SRCH
	JP	NZ,ERHW1
	POP	AF
	JP	RUN2
;
RUN:	CALL	TSCR2
	LD	DE,OTOP
RUN1:	LD	HL,0000H
	CALL	SRCH1
	JP	C,START
RUN2:	EX	DE,HL
	LD	(CLABL),HL
	EX	DE,HL
	INC	DE
	INC	DE
NXTGO:	CALL	BREAK
	LD	HL,STMKW-1
	JP	NXTKW
;
ENDL:	CALL	TSTSC
LERR:	JP	ERWHT
;
TSTSC:	MTST	3BH,TSCR1
	POP	AF
	JP	NXTGO
;
TSCR1:	MTST	0DH,TSRTN
	POP	AF
	JP	RUN1
TSRTN:	RET
;
TSCR2:	CALL	SKPBL
	CP	0DH
	RET	Z
	JP	ERWHT
;
EEXPR:	CALL	EXPR
	PUSH	HL
	LD	HL,ROPKW-1
	JP	NXTKW
ROPKW:	CASE	'>=',GE1
	CASE	'<>',NE1
	CASE	'>',GT1
	CASE	'=',EQ1
	CASE	'<=',LE1
	CASE	'<',LT1
	MENDC	NOROP
;
GE1:	CALL	IFEXQ
	RET	C
	LD	L,A
	RET
;
NE1:	CALL	IFEXQ
	RET	Z
	LD	L,A
	RET
;
GT1:	CALL	IFEXQ
	RET	Z
	RET	C
	LD	L,A
	RET
LE1:	CALL	IFEXQ
	LD	L,A
	RET	Z
	RET	C
	LD	L,H
	RET
EQ1:	CALL	IFEXQ
	RET	NZ
	LD	L,A
	RET
LT1:	CALL	IFEXQ
	RET	NC
	LD	L,A
	RET
NOROP:	POP	HL
	RET
;
IFEXQ:	LD	A,C
	POP	HL
	POP	BC
	PUSH	HL
	PUSH	BC
	LD	C,A
	CALL	EXPR
	EX	DE,HL
	EX	(SP),HL
	CALL	CMINT
	POP	DE
	LD	HL,0000H
	LD	A,01H
	RET
;
EXPR:	MTST	2DH,EXPR1
	LD	HL,0000H
	JP	NEGA1
EXPR1:	MTST	2BH,EXPR3
EXPR3:	CALL	TERM
EXPR2:	MTST	2BH,NEGA0
	PUSH	HL
	CALL	TERM
	JP	ADDBL
NEGA0:	MTST	2DH,EXPRT
NEGA1:	PUSH	HL
	CALL	TERM
	CALL	TWSCP
ADDBL:	EX	DE,HL
	EX	(SP),HL
	LD	A,H
	XOR	D
	LD	A,D
	ADD	HL,DE
	POP	DE
	JP	M,EXPR2
	XOR	H
	JP	P,EXPR2
	JP	ERHOW
;
TERM:	CALL	FACTR
MULT:	MTST	2AH,DIV
	PUSH	HL
	CALL	FACTR
	LD	B,00H
	CALL	ABS
	EX	DE,HL
	EX	(SP),HL
	CALL	ABS
	LD	A,H
	OR	A
	JP	Z,MULT1
	LD	A,D
	OR	D
	EX	DE,HL
	JP	NZ,ERHW1
MULT1:	LD	A,L
	LD	L,0
	OR	A
	JP	Z,TERM1
MULTL:	ADD	HL,DE
	JP	C,ERHW1
	DEC	A
	JP	NZ,MULTL
	JP	TERM1
DIV:	MTST	2FH,EXPRT
	PUSH	HL
	CALL	FACTR
	LD	B,00H
	CALL	ABS
	EX	DE,HL
	EX	(SP),HL
	CALL	ABS
	LD	A,D
	OR	E
	JP	Z,ERHW1
	PUSH	BC
	CALL	DIVID
	LD	H,B
	LD	L,C
	POP	BC
TERM1:	POP	DE
	LD	A,H
	OR	A
	JP	M,ERHOW
	LD	A,B
	OR	A
	CALL	M,TWSCP
	JP	MULT
;
DIVID:	PUSH	HL
	LD	L,H
	LD	H,00H
	CALL	DIVSB
	LD	B,C
	LD	A,L
	POP	HL
	LD	H,A
DIVSB:	LD	C,0FFH
DIVS1:	INC	C
	CALL	DIFF
	JP	NC,DIVS1
	ADD	HL,DE
EXPRT:	RET
;
DIFF:	LD	A,L
	SUB	E
	LD	L,A
	LD	A,H
	SBC	A,D
	LD	H,A
	RET
;
ABS:	LD	A,H
	OR	A
	RET	P
TWSCP:	LD	A,H
	CPL
	LD	H,A
	LD	A,L
	CPL
	LD	L,A
	INC	HL
	LD	A,B
	XOR	80H
	LD	B,A
	RET
;
CMINT:	LD	A,H
	XOR	D
	JP	P,COMPR
	EX	DE,HL
COMPR:	LD	A,H
	CP	D
	RET	NZ
	LD	A,L
	CP	E
	RET
;
FACTR:	LD	HL,FNKW-1
	JP	NXTKW
FNKW:	CASE	'RND',RND
	CASE	'ABS',FNABS
	CASE	'SIZE',RSIZE
	MENDC	VAR
;
RND:	CALL	EXPR0
	LD	A,H
	OR	A
	JP	M,ERHOW
	OR	L
	JP	Z,ERHOW
	PUSH	DE
	PUSH	HL
	LD	HL,(RWRK)
;;	INC	HL
	LD	A,H
	AND	07H
	LD	H,A
;;	DEC	L
	LD	DE,ITOP	;
	ADD	HL,DE	;
RND1:	LD	E,(HL)
	INC	HL
	LD	D,(HL)
	LD	(RWRK),HL
	POP	HL
	EX	DE,HL
	PUSH	BC
	CALL	DIVID
	POP	BC
	POP	DE
	INC	HL
	RET
;
FNABS:	CALL	EXPR0
	CALL	ABS
	LD	A,H
	OR	H
	JP	M,ERHOW
	RET
;
RSIZE:	LD	HL,(OBTM)
	PUSH	DE
	EX	DE,HL
	LD	HL,VTOP
	CALL	DIFF
	POP	DE
	RET
;
VAR:	CALL	TSTV
	JP	C,NUMB
	LD	A,(HL)
	INC	HL
	LD	H,(HL)
	LD	L,A
	RET
;
TSTV:	CALL	SKPBL
	SUB	'@'
	RET	C
	JP	NZ,TSTV1
	INC	DE
	CALL	EXPR0
	ADD	HL,HL
	JP	C,ERHOW
	PUSH	DE
	EX	DE,HL
	CALL	RSIZE
	CALL	COMPR
	JP	C,ERSY1
	LD	HL,VTOP
	CALL	DIFF
	POP	DE
	RET
TSTV1:	CP	'Z'+1-'@'
	CCF
	RET	C
	INC	DE
	LD	HL,VTOP
	RLCA
	ADD	A,L
	LD	L,A
	LD	A,00H
	ADC	A,H
	LD	H,A
	RET
;
GINT:	LD	HL,0000H
	LD	B,H
	CALL	SKPBL
GETI1:	CP	'0'
	RET	C
	CP	'9'+1
	RET	NC
	LD	A,0F0H
	AND	H
	JP	NZ,ERHOW
	INC	B
	PUSH	BC
	LD	B,H
	LD	C,L
	ADD	HL,HL
	ADD	HL,HL
	ADD	HL,BC
	ADD	HL,HL
	LD	A,(DE)
	INC	DE
	AND	0FH
	ADD	A,L
	LD	L,A
	LD	A,00H
	ADC	A,H
	LD	H,A
	POP	BC
	LD	A,(DE)
	JP	M,ERHOW
	JP	GETI1
;
NUMB:	CALL	GINT
	LD	A,B
	OR	A
	RET	NZ
;
EXPR0:	MTST	28H,ERWHT
	CALL	EEXPR
	MTST	29H,ERWHT
	RET
;
ERWHT:	PUSH	DE
ERWT1:	LD	DE,WHTMS
	JP	LERMS
ERHOW:	PUSH	DE
ERHW1:	LD	DE,HOWMS
	JP	LERMS
ERSRY:	PUSH	DE
ERSY1:	LD	DE,SRYMS
LERMS:	SUB	A
	CALL	MSG
	POP	DE
	LD	A,(DE)
	PUSH	AF
	SUB	A
	LD	(DE),A
	LD	HL,(CLABL)
	PUSH	HL
	LD	A,(HL)
	INC	HL
	OR	(HL)
	POP	DE
	JP	Z,START
	LD	A,(HL)
	OR	A
	JP	M,ERRIN
	CALL	WLINE
	DEC	DE
	POP	AF
	LD	(DE),A
	LD	A,'?'
	CALL	PUT
	SUB	A
	CALL	MSG
	JP	START
;
OKMES:	DB	'OK'
	DB	0DH
HOWMS:	DB	'HOW?'
	DB	0DH
WHTMS:	DB	'WHAT?'
	DB	0DH
SRYMS:	DB	'SORRY'
	DB	0DH
;
OPNMS1:	DB	'PALO ALTO '
	DB	'TINY BASIC'
	DB	0DH
OPNMS2:	DB	'PORTABLE '
	DB	'Z80 VERSION'
	DB	0DH
OPNMS3:	DB	'AKI-80 EDITION'
	DB	0DH
;
MSG:	LD	B,A
MSG1:	LD	A,(DE)
	INC	DE
	CP	B
	RET	Z
	CALL	PUT
	CP	0DH
	JP	NZ,MSG1
	RET
;
CRLF:	LD	A,0DH
PUT:	PUSH	AF
	PUSH	BC
	PUSH	DE
	PUSH	HL
	LD	C,02H
	AND	07FH
	LD	E,A
	CALL	0005H
	POP	HL
	POP	DE
	POP	BC
	POP	AF
;
	CP	0DH
	RET	NZ
	LD	A,0AH
	CALL	PUT
	LD	A,0DH
	RET
;
BREAK	EQU	$
GET:
	PUSH	BC
	PUSH	DE
	PUSH	HL
	LD	C,06H
	LD	E,0FFH
	CALL	0005H
	POP	HL
	POP	DE
	POP	BC
	AND	7FH
	RET	Z
	CP	ESC
	JP	NZ,GET1
	INC	SP
	INC	SP
	JP	START
;
GET1:	CP	'a'
	RET	C
	CP	'z'+1
	RET	NC
	AND	11011111B
	RET
;
	ORG	LTOP
;
OBTM:	DS	0002H
CLABL:	DS	0002H
RSTCK:	DS	0002H
NCNTR:	DS	0002H
FCNTR:	DS	0002H
FSTPV:	DS	0002H
FTOV:	DS	0002H
FLABL:	DS	0002H
FOBJ:	DS	0002H
RWRK:	DS	0002H
OTOP	EQU	$
;
;	SYSTEM PARAMETERS
	ORG	0FEFCH
RBFCNT	DS	01H
RBFRDP	DS	01H
RBFWTP	DS	01H
XFLAGS	DS	01H
RECBUF	DS	100H
;
	END	0000H
