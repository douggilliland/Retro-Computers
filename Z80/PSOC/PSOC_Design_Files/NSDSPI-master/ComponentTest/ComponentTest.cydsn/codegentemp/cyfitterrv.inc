;
; File Name: cyfitterrv.inc
; 
; PSoC Creator  4.2
;
; Description:
; 
;
;-------------------------------------------------------------------------------
; Copyright (c) 2007-2018 Cypress Semiconductor.  All rights reserved.
; You may use this file only in accordance with the license, terms, conditions, 
; disclaimers, and limitations in the end user license agreement accompanying 
; the software package with which this file was provided.
;-------------------------------------------------------------------------------

    IF :LNOT::DEF:INCLUDED_CYFITTERRV_INC
INCLUDED_CYFITTERRV_INC EQU 1
    GET cydevicerv.inc
    GET cydevicerv_trm.inc

; Pin_1
Pin_1__0__INTTYPE EQU CYREG_PICU0_INTTYPE7
Pin_1__0__MASK EQU 0x80
Pin_1__0__PC EQU CYREG_PRT0_PC7
Pin_1__0__PORT EQU 0
Pin_1__0__SHIFT EQU 7
Pin_1__AG EQU CYREG_PRT0_AG
Pin_1__AMUX EQU CYREG_PRT0_AMUX
Pin_1__BIE EQU CYREG_PRT0_BIE
Pin_1__BIT_MASK EQU CYREG_PRT0_BIT_MASK
Pin_1__BYP EQU CYREG_PRT0_BYP
Pin_1__CTL EQU CYREG_PRT0_CTL
Pin_1__DM0 EQU CYREG_PRT0_DM0
Pin_1__DM1 EQU CYREG_PRT0_DM1
Pin_1__DM2 EQU CYREG_PRT0_DM2
Pin_1__DR EQU CYREG_PRT0_DR
Pin_1__INP_DIS EQU CYREG_PRT0_INP_DIS
Pin_1__INTTYPE_BASE EQU CYDEV_PICU_INTTYPE_PICU0_BASE
Pin_1__LCD_COM_SEG EQU CYREG_PRT0_LCD_COM_SEG
Pin_1__LCD_EN EQU CYREG_PRT0_LCD_EN
Pin_1__MASK EQU 0x80
Pin_1__PORT EQU 0
Pin_1__PRT EQU CYREG_PRT0_PRT
Pin_1__PRTDSI__CAPS_SEL EQU CYREG_PRT0_CAPS_SEL
Pin_1__PRTDSI__DBL_SYNC_IN EQU CYREG_PRT0_DBL_SYNC_IN
Pin_1__PRTDSI__OE_SEL0 EQU CYREG_PRT0_OE_SEL0
Pin_1__PRTDSI__OE_SEL1 EQU CYREG_PRT0_OE_SEL1
Pin_1__PRTDSI__OUT_SEL0 EQU CYREG_PRT0_OUT_SEL0
Pin_1__PRTDSI__OUT_SEL1 EQU CYREG_PRT0_OUT_SEL1
Pin_1__PRTDSI__SYNC_OUT EQU CYREG_PRT0_SYNC_OUT
Pin_1__PS EQU CYREG_PRT0_PS
Pin_1__SHIFT EQU 7
Pin_1__SLW EQU CYREG_PRT0_SLW

; SD_CS
SD_CS__0__INTTYPE EQU CYREG_PICU3_INTTYPE1
SD_CS__0__MASK EQU 0x02
SD_CS__0__PC EQU CYREG_PRT3_PC1
SD_CS__0__PORT EQU 3
SD_CS__0__SHIFT EQU 1
SD_CS__AG EQU CYREG_PRT3_AG
SD_CS__AMUX EQU CYREG_PRT3_AMUX
SD_CS__BIE EQU CYREG_PRT3_BIE
SD_CS__BIT_MASK EQU CYREG_PRT3_BIT_MASK
SD_CS__BYP EQU CYREG_PRT3_BYP
SD_CS__CTL EQU CYREG_PRT3_CTL
SD_CS__DM0 EQU CYREG_PRT3_DM0
SD_CS__DM1 EQU CYREG_PRT3_DM1
SD_CS__DM2 EQU CYREG_PRT3_DM2
SD_CS__DR EQU CYREG_PRT3_DR
SD_CS__INP_DIS EQU CYREG_PRT3_INP_DIS
SD_CS__INTTYPE_BASE EQU CYDEV_PICU_INTTYPE_PICU3_BASE
SD_CS__LCD_COM_SEG EQU CYREG_PRT3_LCD_COM_SEG
SD_CS__LCD_EN EQU CYREG_PRT3_LCD_EN
SD_CS__MASK EQU 0x02
SD_CS__PORT EQU 3
SD_CS__PRT EQU CYREG_PRT3_PRT
SD_CS__PRTDSI__CAPS_SEL EQU CYREG_PRT3_CAPS_SEL
SD_CS__PRTDSI__DBL_SYNC_IN EQU CYREG_PRT3_DBL_SYNC_IN
SD_CS__PRTDSI__OE_SEL0 EQU CYREG_PRT3_OE_SEL0
SD_CS__PRTDSI__OE_SEL1 EQU CYREG_PRT3_OE_SEL1
SD_CS__PRTDSI__OUT_SEL0 EQU CYREG_PRT3_OUT_SEL0
SD_CS__PRTDSI__OUT_SEL1 EQU CYREG_PRT3_OUT_SEL1
SD_CS__PRTDSI__SYNC_OUT EQU CYREG_PRT3_SYNC_OUT
SD_CS__PS EQU CYREG_PRT3_PS
SD_CS__SHIFT EQU 1
SD_CS__SLW EQU CYREG_PRT3_SLW

; NSDSPI
NSDSPI_CTRL_Sync_ctrl_reg__0__MASK EQU 0x01
NSDSPI_CTRL_Sync_ctrl_reg__0__POS EQU 0
NSDSPI_CTRL_Sync_ctrl_reg__1__MASK EQU 0x02
NSDSPI_CTRL_Sync_ctrl_reg__1__POS EQU 1
NSDSPI_CTRL_Sync_ctrl_reg__16BIT_CONTROL_AUX_CTL_REG EQU CYREG_B0_UDB11_12_ACTL
NSDSPI_CTRL_Sync_ctrl_reg__16BIT_CONTROL_CONTROL_REG EQU CYREG_B0_UDB11_12_CTL
NSDSPI_CTRL_Sync_ctrl_reg__16BIT_CONTROL_COUNT_REG EQU CYREG_B0_UDB11_12_CTL
NSDSPI_CTRL_Sync_ctrl_reg__16BIT_COUNT_CONTROL_REG EQU CYREG_B0_UDB11_12_CTL
NSDSPI_CTRL_Sync_ctrl_reg__16BIT_COUNT_COUNT_REG EQU CYREG_B0_UDB11_12_CTL
NSDSPI_CTRL_Sync_ctrl_reg__16BIT_MASK_MASK_REG EQU CYREG_B0_UDB11_12_MSK
NSDSPI_CTRL_Sync_ctrl_reg__16BIT_MASK_PERIOD_REG EQU CYREG_B0_UDB11_12_MSK
NSDSPI_CTRL_Sync_ctrl_reg__16BIT_PERIOD_MASK_REG EQU CYREG_B0_UDB11_12_MSK
NSDSPI_CTRL_Sync_ctrl_reg__16BIT_PERIOD_PERIOD_REG EQU CYREG_B0_UDB11_12_MSK
NSDSPI_CTRL_Sync_ctrl_reg__2__MASK EQU 0x04
NSDSPI_CTRL_Sync_ctrl_reg__2__POS EQU 2
NSDSPI_CTRL_Sync_ctrl_reg__CONTROL_AUX_CTL_REG EQU CYREG_B0_UDB11_ACTL
NSDSPI_CTRL_Sync_ctrl_reg__CONTROL_REG EQU CYREG_B0_UDB11_CTL
NSDSPI_CTRL_Sync_ctrl_reg__CONTROL_ST_REG EQU CYREG_B0_UDB11_ST_CTL
NSDSPI_CTRL_Sync_ctrl_reg__COUNT_REG EQU CYREG_B0_UDB11_CTL
NSDSPI_CTRL_Sync_ctrl_reg__COUNT_ST_REG EQU CYREG_B0_UDB11_ST_CTL
NSDSPI_CTRL_Sync_ctrl_reg__MASK EQU 0x07
NSDSPI_CTRL_Sync_ctrl_reg__MASK_CTL_AUX_CTL_REG EQU CYREG_B0_UDB11_MSK_ACTL
NSDSPI_CTRL_Sync_ctrl_reg__PER_CTL_AUX_CTL_REG EQU CYREG_B0_UDB11_MSK_ACTL
NSDSPI_CTRL_Sync_ctrl_reg__PERIOD_REG EQU CYREG_B0_UDB11_MSK
NSDSPI_RX__DRQ_CTL EQU CYREG_IDMUX_DRQ_CTL0
NSDSPI_RX__DRQ_NUMBER EQU 0
NSDSPI_RX__NUMBEROF_TDS EQU 0
NSDSPI_RX__PRIORITY EQU 1
NSDSPI_RX__TERMIN_EN EQU 0
NSDSPI_RX__TERMIN_SEL EQU 0
NSDSPI_RX__TERMOUT0_EN EQU 1
NSDSPI_RX__TERMOUT0_SEL EQU 0
NSDSPI_RX__TERMOUT1_EN EQU 0
NSDSPI_RX__TERMOUT1_SEL EQU 0
NSDSPI_RX_BYTE_COUNTER_CounterUDB_sC16_counterdp_u0__16BIT_A0_REG EQU CYREG_B0_UDB10_11_A0
NSDSPI_RX_BYTE_COUNTER_CounterUDB_sC16_counterdp_u0__16BIT_A1_REG EQU CYREG_B0_UDB10_11_A1
NSDSPI_RX_BYTE_COUNTER_CounterUDB_sC16_counterdp_u0__16BIT_D0_REG EQU CYREG_B0_UDB10_11_D0
NSDSPI_RX_BYTE_COUNTER_CounterUDB_sC16_counterdp_u0__16BIT_D1_REG EQU CYREG_B0_UDB10_11_D1
NSDSPI_RX_BYTE_COUNTER_CounterUDB_sC16_counterdp_u0__16BIT_DP_AUX_CTL_REG EQU CYREG_B0_UDB10_11_ACTL
NSDSPI_RX_BYTE_COUNTER_CounterUDB_sC16_counterdp_u0__16BIT_F0_REG EQU CYREG_B0_UDB10_11_F0
NSDSPI_RX_BYTE_COUNTER_CounterUDB_sC16_counterdp_u0__16BIT_F1_REG EQU CYREG_B0_UDB10_11_F1
NSDSPI_RX_BYTE_COUNTER_CounterUDB_sC16_counterdp_u0__A0_A1_REG EQU CYREG_B0_UDB10_A0_A1
NSDSPI_RX_BYTE_COUNTER_CounterUDB_sC16_counterdp_u0__A0_REG EQU CYREG_B0_UDB10_A0
NSDSPI_RX_BYTE_COUNTER_CounterUDB_sC16_counterdp_u0__A1_REG EQU CYREG_B0_UDB10_A1
NSDSPI_RX_BYTE_COUNTER_CounterUDB_sC16_counterdp_u0__D0_D1_REG EQU CYREG_B0_UDB10_D0_D1
NSDSPI_RX_BYTE_COUNTER_CounterUDB_sC16_counterdp_u0__D0_REG EQU CYREG_B0_UDB10_D0
NSDSPI_RX_BYTE_COUNTER_CounterUDB_sC16_counterdp_u0__D1_REG EQU CYREG_B0_UDB10_D1
NSDSPI_RX_BYTE_COUNTER_CounterUDB_sC16_counterdp_u0__DP_AUX_CTL_REG EQU CYREG_B0_UDB10_ACTL
NSDSPI_RX_BYTE_COUNTER_CounterUDB_sC16_counterdp_u0__F0_F1_REG EQU CYREG_B0_UDB10_F0_F1
NSDSPI_RX_BYTE_COUNTER_CounterUDB_sC16_counterdp_u0__F0_REG EQU CYREG_B0_UDB10_F0
NSDSPI_RX_BYTE_COUNTER_CounterUDB_sC16_counterdp_u0__F1_REG EQU CYREG_B0_UDB10_F1
NSDSPI_RX_BYTE_COUNTER_CounterUDB_sC16_counterdp_u1__16BIT_A0_REG EQU CYREG_B0_UDB11_12_A0
NSDSPI_RX_BYTE_COUNTER_CounterUDB_sC16_counterdp_u1__16BIT_A1_REG EQU CYREG_B0_UDB11_12_A1
NSDSPI_RX_BYTE_COUNTER_CounterUDB_sC16_counterdp_u1__16BIT_D0_REG EQU CYREG_B0_UDB11_12_D0
NSDSPI_RX_BYTE_COUNTER_CounterUDB_sC16_counterdp_u1__16BIT_D1_REG EQU CYREG_B0_UDB11_12_D1
NSDSPI_RX_BYTE_COUNTER_CounterUDB_sC16_counterdp_u1__16BIT_DP_AUX_CTL_REG EQU CYREG_B0_UDB11_12_ACTL
NSDSPI_RX_BYTE_COUNTER_CounterUDB_sC16_counterdp_u1__16BIT_F0_REG EQU CYREG_B0_UDB11_12_F0
NSDSPI_RX_BYTE_COUNTER_CounterUDB_sC16_counterdp_u1__16BIT_F1_REG EQU CYREG_B0_UDB11_12_F1
NSDSPI_RX_BYTE_COUNTER_CounterUDB_sC16_counterdp_u1__A0_A1_REG EQU CYREG_B0_UDB11_A0_A1
NSDSPI_RX_BYTE_COUNTER_CounterUDB_sC16_counterdp_u1__A0_REG EQU CYREG_B0_UDB11_A0
NSDSPI_RX_BYTE_COUNTER_CounterUDB_sC16_counterdp_u1__A1_REG EQU CYREG_B0_UDB11_A1
NSDSPI_RX_BYTE_COUNTER_CounterUDB_sC16_counterdp_u1__D0_D1_REG EQU CYREG_B0_UDB11_D0_D1
NSDSPI_RX_BYTE_COUNTER_CounterUDB_sC16_counterdp_u1__D0_REG EQU CYREG_B0_UDB11_D0
NSDSPI_RX_BYTE_COUNTER_CounterUDB_sC16_counterdp_u1__D1_REG EQU CYREG_B0_UDB11_D1
NSDSPI_RX_BYTE_COUNTER_CounterUDB_sC16_counterdp_u1__DP_AUX_CTL_REG EQU CYREG_B0_UDB11_ACTL
NSDSPI_RX_BYTE_COUNTER_CounterUDB_sC16_counterdp_u1__F0_F1_REG EQU CYREG_B0_UDB11_F0_F1
NSDSPI_RX_BYTE_COUNTER_CounterUDB_sC16_counterdp_u1__F0_REG EQU CYREG_B0_UDB11_F0
NSDSPI_RX_BYTE_COUNTER_CounterUDB_sC16_counterdp_u1__F1_REG EQU CYREG_B0_UDB11_F1
NSDSPI_RX_BYTE_COUNTER_CounterUDB_sC16_counterdp_u1__MSK_DP_AUX_CTL_REG EQU CYREG_B0_UDB11_MSK_ACTL
NSDSPI_RX_BYTE_COUNTER_CounterUDB_sC16_counterdp_u1__PER_DP_AUX_CTL_REG EQU CYREG_B0_UDB11_MSK_ACTL
NSDSPI_RX_BYTE_COUNTER_CounterUDB_sSTSReg_stsreg__0__MASK EQU 0x01
NSDSPI_RX_BYTE_COUNTER_CounterUDB_sSTSReg_stsreg__0__POS EQU 0
NSDSPI_RX_BYTE_COUNTER_CounterUDB_sSTSReg_stsreg__1__MASK EQU 0x02
NSDSPI_RX_BYTE_COUNTER_CounterUDB_sSTSReg_stsreg__1__POS EQU 1
NSDSPI_RX_BYTE_COUNTER_CounterUDB_sSTSReg_stsreg__16BIT_STATUS_AUX_CTL_REG EQU CYREG_B0_UDB11_12_ACTL
NSDSPI_RX_BYTE_COUNTER_CounterUDB_sSTSReg_stsreg__16BIT_STATUS_REG EQU CYREG_B0_UDB11_12_ST
NSDSPI_RX_BYTE_COUNTER_CounterUDB_sSTSReg_stsreg__2__MASK EQU 0x04
NSDSPI_RX_BYTE_COUNTER_CounterUDB_sSTSReg_stsreg__2__POS EQU 2
NSDSPI_RX_BYTE_COUNTER_CounterUDB_sSTSReg_stsreg__5__MASK EQU 0x20
NSDSPI_RX_BYTE_COUNTER_CounterUDB_sSTSReg_stsreg__5__POS EQU 5
NSDSPI_RX_BYTE_COUNTER_CounterUDB_sSTSReg_stsreg__6__MASK EQU 0x40
NSDSPI_RX_BYTE_COUNTER_CounterUDB_sSTSReg_stsreg__6__POS EQU 6
NSDSPI_RX_BYTE_COUNTER_CounterUDB_sSTSReg_stsreg__MASK EQU 0x67
NSDSPI_RX_BYTE_COUNTER_CounterUDB_sSTSReg_stsreg__MASK_REG EQU CYREG_B0_UDB11_MSK
NSDSPI_RX_BYTE_COUNTER_CounterUDB_sSTSReg_stsreg__MASK_ST_AUX_CTL_REG EQU CYREG_B0_UDB11_MSK_ACTL
NSDSPI_RX_BYTE_COUNTER_CounterUDB_sSTSReg_stsreg__PER_ST_AUX_CTL_REG EQU CYREG_B0_UDB11_MSK_ACTL
NSDSPI_RX_BYTE_COUNTER_CounterUDB_sSTSReg_stsreg__STATUS_AUX_CTL_REG EQU CYREG_B0_UDB11_ACTL
NSDSPI_RX_BYTE_COUNTER_CounterUDB_sSTSReg_stsreg__STATUS_CNT_REG EQU CYREG_B0_UDB11_ST_CTL
NSDSPI_RX_BYTE_COUNTER_CounterUDB_sSTSReg_stsreg__STATUS_CONTROL_REG EQU CYREG_B0_UDB11_ST_CTL
NSDSPI_RX_BYTE_COUNTER_CounterUDB_sSTSReg_stsreg__STATUS_REG EQU CYREG_B0_UDB11_ST
NSDSPI_RX_DMA_ISR__INTC_CLR_EN_REG EQU CYREG_NVIC_CLRENA0
NSDSPI_RX_DMA_ISR__INTC_CLR_PD_REG EQU CYREG_NVIC_CLRPEND0
NSDSPI_RX_DMA_ISR__INTC_MASK EQU 0x02
NSDSPI_RX_DMA_ISR__INTC_NUMBER EQU 1
NSDSPI_RX_DMA_ISR__INTC_PRIOR_NUM EQU 1
NSDSPI_RX_DMA_ISR__INTC_PRIOR_REG EQU CYREG_NVIC_PRI_1
NSDSPI_RX_DMA_ISR__INTC_SET_EN_REG EQU CYREG_NVIC_SETENA0
NSDSPI_RX_DMA_ISR__INTC_SET_PD_REG EQU CYREG_NVIC_SETPEND0
NSDSPI_RX_ISR__INTC_CLR_EN_REG EQU CYREG_NVIC_CLRENA0
NSDSPI_RX_ISR__INTC_CLR_PD_REG EQU CYREG_NVIC_CLRPEND0
NSDSPI_RX_ISR__INTC_MASK EQU 0x04
NSDSPI_RX_ISR__INTC_NUMBER EQU 2
NSDSPI_RX_ISR__INTC_PRIOR_NUM EQU 2
NSDSPI_RX_ISR__INTC_PRIOR_REG EQU CYREG_NVIC_PRI_2
NSDSPI_RX_ISR__INTC_SET_EN_REG EQU CYREG_NVIC_SETENA0
NSDSPI_RX_ISR__INTC_SET_PD_REG EQU CYREG_NVIC_SETPEND0
NSDSPI_TX__DRQ_CTL EQU CYREG_IDMUX_DRQ_CTL0
NSDSPI_TX__DRQ_NUMBER EQU 1
NSDSPI_TX__NUMBEROF_TDS EQU 0
NSDSPI_TX__PRIORITY EQU 2
NSDSPI_TX__TERMIN_EN EQU 0
NSDSPI_TX__TERMIN_SEL EQU 0
NSDSPI_TX__TERMOUT0_EN EQU 1
NSDSPI_TX__TERMOUT0_SEL EQU 1
NSDSPI_TX__TERMOUT1_EN EQU 0
NSDSPI_TX__TERMOUT1_SEL EQU 0
NSDSPI_TX_DMA_ISR__INTC_CLR_EN_REG EQU CYREG_NVIC_CLRENA0
NSDSPI_TX_DMA_ISR__INTC_CLR_PD_REG EQU CYREG_NVIC_CLRPEND0
NSDSPI_TX_DMA_ISR__INTC_MASK EQU 0x08
NSDSPI_TX_DMA_ISR__INTC_NUMBER EQU 3
NSDSPI_TX_DMA_ISR__INTC_PRIOR_NUM EQU 2
NSDSPI_TX_DMA_ISR__INTC_PRIOR_REG EQU CYREG_NVIC_PRI_3
NSDSPI_TX_DMA_ISR__INTC_SET_EN_REG EQU CYREG_NVIC_SETENA0
NSDSPI_TX_DMA_ISR__INTC_SET_PD_REG EQU CYREG_NVIC_SETPEND0
NSDSPI_UDB_BIT_COUNTER_Counter7__16BIT_CONTROL_AUX_CTL_REG EQU CYREG_B0_UDB12_13_ACTL
NSDSPI_UDB_BIT_COUNTER_Counter7__16BIT_CONTROL_CONTROL_REG EQU CYREG_B0_UDB12_13_CTL
NSDSPI_UDB_BIT_COUNTER_Counter7__16BIT_CONTROL_COUNT_REG EQU CYREG_B0_UDB12_13_CTL
NSDSPI_UDB_BIT_COUNTER_Counter7__16BIT_COUNT_CONTROL_REG EQU CYREG_B0_UDB12_13_CTL
NSDSPI_UDB_BIT_COUNTER_Counter7__16BIT_COUNT_COUNT_REG EQU CYREG_B0_UDB12_13_CTL
NSDSPI_UDB_BIT_COUNTER_Counter7__16BIT_MASK_MASK_REG EQU CYREG_B0_UDB12_13_MSK
NSDSPI_UDB_BIT_COUNTER_Counter7__16BIT_MASK_PERIOD_REG EQU CYREG_B0_UDB12_13_MSK
NSDSPI_UDB_BIT_COUNTER_Counter7__16BIT_PERIOD_MASK_REG EQU CYREG_B0_UDB12_13_MSK
NSDSPI_UDB_BIT_COUNTER_Counter7__16BIT_PERIOD_PERIOD_REG EQU CYREG_B0_UDB12_13_MSK
NSDSPI_UDB_BIT_COUNTER_Counter7__CONTROL_AUX_CTL_REG EQU CYREG_B0_UDB12_ACTL
NSDSPI_UDB_BIT_COUNTER_Counter7__CONTROL_REG EQU CYREG_B0_UDB12_CTL
NSDSPI_UDB_BIT_COUNTER_Counter7__CONTROL_ST_REG EQU CYREG_B0_UDB12_ST_CTL
NSDSPI_UDB_BIT_COUNTER_Counter7__COUNT_REG EQU CYREG_B0_UDB12_CTL
NSDSPI_UDB_BIT_COUNTER_Counter7__COUNT_ST_REG EQU CYREG_B0_UDB12_ST_CTL
NSDSPI_UDB_BIT_COUNTER_Counter7__MASK_CTL_AUX_CTL_REG EQU CYREG_B0_UDB12_MSK_ACTL
NSDSPI_UDB_BIT_COUNTER_Counter7__PER_CTL_AUX_CTL_REG EQU CYREG_B0_UDB12_MSK_ACTL
NSDSPI_UDB_BIT_COUNTER_Counter7__PERIOD_REG EQU CYREG_B0_UDB12_MSK
NSDSPI_UDB_BIT_COUNTER_Counter7_ST__16BIT_STATUS_AUX_CTL_REG EQU CYREG_B0_UDB12_13_ACTL
NSDSPI_UDB_BIT_COUNTER_Counter7_ST__16BIT_STATUS_REG EQU CYREG_B0_UDB12_13_ST
NSDSPI_UDB_BIT_COUNTER_Counter7_ST__MASK_REG EQU CYREG_B0_UDB12_MSK
NSDSPI_UDB_BIT_COUNTER_Counter7_ST__MASK_ST_AUX_CTL_REG EQU CYREG_B0_UDB12_MSK_ACTL
NSDSPI_UDB_BIT_COUNTER_Counter7_ST__PER_ST_AUX_CTL_REG EQU CYREG_B0_UDB12_MSK_ACTL
NSDSPI_UDB_BIT_COUNTER_Counter7_ST__STATUS_AUX_CTL_REG EQU CYREG_B0_UDB12_ACTL
NSDSPI_UDB_BIT_COUNTER_Counter7_ST__STATUS_CNT_REG EQU CYREG_B0_UDB12_ST_CTL
NSDSPI_UDB_BIT_COUNTER_Counter7_ST__STATUS_CONTROL_REG EQU CYREG_B0_UDB12_ST_CTL
NSDSPI_UDB_BIT_COUNTER_Counter7_ST__STATUS_REG EQU CYREG_B0_UDB12_ST
NSDSPI_UDB_SPI_DPTH_u0__16BIT_A0_REG EQU CYREG_B0_UDB12_13_A0
NSDSPI_UDB_SPI_DPTH_u0__16BIT_A1_REG EQU CYREG_B0_UDB12_13_A1
NSDSPI_UDB_SPI_DPTH_u0__16BIT_D0_REG EQU CYREG_B0_UDB12_13_D0
NSDSPI_UDB_SPI_DPTH_u0__16BIT_D1_REG EQU CYREG_B0_UDB12_13_D1
NSDSPI_UDB_SPI_DPTH_u0__16BIT_DP_AUX_CTL_REG EQU CYREG_B0_UDB12_13_ACTL
NSDSPI_UDB_SPI_DPTH_u0__16BIT_F0_REG EQU CYREG_B0_UDB12_13_F0
NSDSPI_UDB_SPI_DPTH_u0__16BIT_F1_REG EQU CYREG_B0_UDB12_13_F1
NSDSPI_UDB_SPI_DPTH_u0__A0_A1_REG EQU CYREG_B0_UDB12_A0_A1
NSDSPI_UDB_SPI_DPTH_u0__A0_REG EQU CYREG_B0_UDB12_A0
NSDSPI_UDB_SPI_DPTH_u0__A1_REG EQU CYREG_B0_UDB12_A1
NSDSPI_UDB_SPI_DPTH_u0__D0_D1_REG EQU CYREG_B0_UDB12_D0_D1
NSDSPI_UDB_SPI_DPTH_u0__D0_REG EQU CYREG_B0_UDB12_D0
NSDSPI_UDB_SPI_DPTH_u0__D1_REG EQU CYREG_B0_UDB12_D1
NSDSPI_UDB_SPI_DPTH_u0__DP_AUX_CTL_REG EQU CYREG_B0_UDB12_ACTL
NSDSPI_UDB_SPI_DPTH_u0__F0_F1_REG EQU CYREG_B0_UDB12_F0_F1
NSDSPI_UDB_SPI_DPTH_u0__F0_REG EQU CYREG_B0_UDB12_F0
NSDSPI_UDB_SPI_DPTH_u0__F1_REG EQU CYREG_B0_UDB12_F1
NSDSPI_UDB_SPI_DPTH_u0__MSK_DP_AUX_CTL_REG EQU CYREG_B0_UDB12_MSK_ACTL
NSDSPI_UDB_SPI_DPTH_u0__PER_DP_AUX_CTL_REG EQU CYREG_B0_UDB12_MSK_ACTL

; SD_CLK
SD_CLK__CFG0 EQU CYREG_CLKDIST_DCFG0_CFG0
SD_CLK__CFG1 EQU CYREG_CLKDIST_DCFG0_CFG1
SD_CLK__CFG2 EQU CYREG_CLKDIST_DCFG0_CFG2
SD_CLK__CFG2_SRC_SEL_MASK EQU 0x07
SD_CLK__INDEX EQU 0x00
SD_CLK__PM_ACT_CFG EQU CYREG_PM_ACT_CFG2
SD_CLK__PM_ACT_MSK EQU 0x01
SD_CLK__PM_STBY_CFG EQU CYREG_PM_STBY_CFG2
SD_CLK__PM_STBY_MSK EQU 0x01

; Clock_1
Clock_1__CFG0 EQU CYREG_CLKDIST_DCFG1_CFG0
Clock_1__CFG1 EQU CYREG_CLKDIST_DCFG1_CFG1
Clock_1__CFG2 EQU CYREG_CLKDIST_DCFG1_CFG2
Clock_1__CFG2_SRC_SEL_MASK EQU 0x07
Clock_1__INDEX EQU 0x01
Clock_1__PM_ACT_CFG EQU CYREG_PM_ACT_CFG2
Clock_1__PM_ACT_MSK EQU 0x02
Clock_1__PM_STBY_CFG EQU CYREG_PM_STBY_CFG2
Clock_1__PM_STBY_MSK EQU 0x02

; SD_MISO
SD_MISO__0__INTTYPE EQU CYREG_PICU3_INTTYPE5
SD_MISO__0__MASK EQU 0x20
SD_MISO__0__PC EQU CYREG_PRT3_PC5
SD_MISO__0__PORT EQU 3
SD_MISO__0__SHIFT EQU 5
SD_MISO__AG EQU CYREG_PRT3_AG
SD_MISO__AMUX EQU CYREG_PRT3_AMUX
SD_MISO__BIE EQU CYREG_PRT3_BIE
SD_MISO__BIT_MASK EQU CYREG_PRT3_BIT_MASK
SD_MISO__BYP EQU CYREG_PRT3_BYP
SD_MISO__CTL EQU CYREG_PRT3_CTL
SD_MISO__DM0 EQU CYREG_PRT3_DM0
SD_MISO__DM1 EQU CYREG_PRT3_DM1
SD_MISO__DM2 EQU CYREG_PRT3_DM2
SD_MISO__DR EQU CYREG_PRT3_DR
SD_MISO__INP_DIS EQU CYREG_PRT3_INP_DIS
SD_MISO__INTTYPE_BASE EQU CYDEV_PICU_INTTYPE_PICU3_BASE
SD_MISO__LCD_COM_SEG EQU CYREG_PRT3_LCD_COM_SEG
SD_MISO__LCD_EN EQU CYREG_PRT3_LCD_EN
SD_MISO__MASK EQU 0x20
SD_MISO__PORT EQU 3
SD_MISO__PRT EQU CYREG_PRT3_PRT
SD_MISO__PRTDSI__CAPS_SEL EQU CYREG_PRT3_CAPS_SEL
SD_MISO__PRTDSI__DBL_SYNC_IN EQU CYREG_PRT3_DBL_SYNC_IN
SD_MISO__PRTDSI__OE_SEL0 EQU CYREG_PRT3_OE_SEL0
SD_MISO__PRTDSI__OE_SEL1 EQU CYREG_PRT3_OE_SEL1
SD_MISO__PRTDSI__OUT_SEL0 EQU CYREG_PRT3_OUT_SEL0
SD_MISO__PRTDSI__OUT_SEL1 EQU CYREG_PRT3_OUT_SEL1
SD_MISO__PRTDSI__SYNC_OUT EQU CYREG_PRT3_SYNC_OUT
SD_MISO__PS EQU CYREG_PRT3_PS
SD_MISO__SHIFT EQU 5
SD_MISO__SLW EQU CYREG_PRT3_SLW

; SD_MOSI
SD_MOSI__0__INTTYPE EQU CYREG_PICU3_INTTYPE3
SD_MOSI__0__MASK EQU 0x08
SD_MOSI__0__PC EQU CYREG_PRT3_PC3
SD_MOSI__0__PORT EQU 3
SD_MOSI__0__SHIFT EQU 3
SD_MOSI__AG EQU CYREG_PRT3_AG
SD_MOSI__AMUX EQU CYREG_PRT3_AMUX
SD_MOSI__BIE EQU CYREG_PRT3_BIE
SD_MOSI__BIT_MASK EQU CYREG_PRT3_BIT_MASK
SD_MOSI__BYP EQU CYREG_PRT3_BYP
SD_MOSI__CTL EQU CYREG_PRT3_CTL
SD_MOSI__DM0 EQU CYREG_PRT3_DM0
SD_MOSI__DM1 EQU CYREG_PRT3_DM1
SD_MOSI__DM2 EQU CYREG_PRT3_DM2
SD_MOSI__DR EQU CYREG_PRT3_DR
SD_MOSI__INP_DIS EQU CYREG_PRT3_INP_DIS
SD_MOSI__INTTYPE_BASE EQU CYDEV_PICU_INTTYPE_PICU3_BASE
SD_MOSI__LCD_COM_SEG EQU CYREG_PRT3_LCD_COM_SEG
SD_MOSI__LCD_EN EQU CYREG_PRT3_LCD_EN
SD_MOSI__MASK EQU 0x08
SD_MOSI__PORT EQU 3
SD_MOSI__PRT EQU CYREG_PRT3_PRT
SD_MOSI__PRTDSI__CAPS_SEL EQU CYREG_PRT3_CAPS_SEL
SD_MOSI__PRTDSI__DBL_SYNC_IN EQU CYREG_PRT3_DBL_SYNC_IN
SD_MOSI__PRTDSI__OE_SEL0 EQU CYREG_PRT3_OE_SEL0
SD_MOSI__PRTDSI__OE_SEL1 EQU CYREG_PRT3_OE_SEL1
SD_MOSI__PRTDSI__OUT_SEL0 EQU CYREG_PRT3_OUT_SEL0
SD_MOSI__PRTDSI__OUT_SEL1 EQU CYREG_PRT3_OUT_SEL1
SD_MOSI__PRTDSI__SYNC_OUT EQU CYREG_PRT3_SYNC_OUT
SD_MOSI__PS EQU CYREG_PRT3_PS
SD_MOSI__SHIFT EQU 3
SD_MOSI__SLW EQU CYREG_PRT3_SLW

; SD_SCLK
SD_SCLK__0__INTTYPE EQU CYREG_PICU3_INTTYPE4
SD_SCLK__0__MASK EQU 0x10
SD_SCLK__0__PC EQU CYREG_PRT3_PC4
SD_SCLK__0__PORT EQU 3
SD_SCLK__0__SHIFT EQU 4
SD_SCLK__AG EQU CYREG_PRT3_AG
SD_SCLK__AMUX EQU CYREG_PRT3_AMUX
SD_SCLK__BIE EQU CYREG_PRT3_BIE
SD_SCLK__BIT_MASK EQU CYREG_PRT3_BIT_MASK
SD_SCLK__BYP EQU CYREG_PRT3_BYP
SD_SCLK__CTL EQU CYREG_PRT3_CTL
SD_SCLK__DM0 EQU CYREG_PRT3_DM0
SD_SCLK__DM1 EQU CYREG_PRT3_DM1
SD_SCLK__DM2 EQU CYREG_PRT3_DM2
SD_SCLK__DR EQU CYREG_PRT3_DR
SD_SCLK__INP_DIS EQU CYREG_PRT3_INP_DIS
SD_SCLK__INTTYPE_BASE EQU CYDEV_PICU_INTTYPE_PICU3_BASE
SD_SCLK__LCD_COM_SEG EQU CYREG_PRT3_LCD_COM_SEG
SD_SCLK__LCD_EN EQU CYREG_PRT3_LCD_EN
SD_SCLK__MASK EQU 0x10
SD_SCLK__PORT EQU 3
SD_SCLK__PRT EQU CYREG_PRT3_PRT
SD_SCLK__PRTDSI__CAPS_SEL EQU CYREG_PRT3_CAPS_SEL
SD_SCLK__PRTDSI__DBL_SYNC_IN EQU CYREG_PRT3_DBL_SYNC_IN
SD_SCLK__PRTDSI__OE_SEL0 EQU CYREG_PRT3_OE_SEL0
SD_SCLK__PRTDSI__OE_SEL1 EQU CYREG_PRT3_OE_SEL1
SD_SCLK__PRTDSI__OUT_SEL0 EQU CYREG_PRT3_OUT_SEL0
SD_SCLK__PRTDSI__OUT_SEL1 EQU CYREG_PRT3_OUT_SEL1
SD_SCLK__PRTDSI__SYNC_OUT EQU CYREG_PRT3_SYNC_OUT
SD_SCLK__PS EQU CYREG_PRT3_PS
SD_SCLK__SHIFT EQU 4
SD_SCLK__SLW EQU CYREG_PRT3_SLW

; MillisecISR
MillisecISR__INTC_CLR_EN_REG EQU CYREG_NVIC_CLRENA0
MillisecISR__INTC_CLR_PD_REG EQU CYREG_NVIC_CLRPEND0
MillisecISR__INTC_MASK EQU 0x01
MillisecISR__INTC_NUMBER EQU 0
MillisecISR__INTC_PRIOR_NUM EQU 3
MillisecISR__INTC_PRIOR_REG EQU CYREG_NVIC_PRI_0
MillisecISR__INTC_SET_EN_REG EQU CYREG_NVIC_SETENA0
MillisecISR__INTC_SET_PD_REG EQU CYREG_NVIC_SETPEND0

; Miscellaneous
BCLK__BUS_CLK__HZ EQU 62000000
BCLK__BUS_CLK__KHZ EQU 62000
BCLK__BUS_CLK__MHZ EQU 62
CYDEV_CHIP_DIE_LEOPARD EQU 1
CYDEV_CHIP_DIE_PSOC4A EQU 18
CYDEV_CHIP_DIE_PSOC5LP EQU 2
CYDEV_CHIP_DIE_PSOC5TM EQU 3
CYDEV_CHIP_DIE_TMA4 EQU 4
CYDEV_CHIP_DIE_UNKNOWN EQU 0
CYDEV_CHIP_FAMILY_FM0P EQU 5
CYDEV_CHIP_FAMILY_FM3 EQU 6
CYDEV_CHIP_FAMILY_FM4 EQU 7
CYDEV_CHIP_FAMILY_PSOC3 EQU 1
CYDEV_CHIP_FAMILY_PSOC4 EQU 2
CYDEV_CHIP_FAMILY_PSOC5 EQU 3
CYDEV_CHIP_FAMILY_PSOC6 EQU 4
CYDEV_CHIP_FAMILY_UNKNOWN EQU 0
CYDEV_CHIP_FAMILY_USED EQU CYDEV_CHIP_FAMILY_PSOC5
CYDEV_CHIP_JTAG_ID EQU 0x2E161069
CYDEV_CHIP_MEMBER_3A EQU 1
CYDEV_CHIP_MEMBER_4A EQU 18
CYDEV_CHIP_MEMBER_4D EQU 13
CYDEV_CHIP_MEMBER_4E EQU 6
CYDEV_CHIP_MEMBER_4F EQU 19
CYDEV_CHIP_MEMBER_4G EQU 4
CYDEV_CHIP_MEMBER_4H EQU 17
CYDEV_CHIP_MEMBER_4I EQU 23
CYDEV_CHIP_MEMBER_4J EQU 14
CYDEV_CHIP_MEMBER_4K EQU 15
CYDEV_CHIP_MEMBER_4L EQU 22
CYDEV_CHIP_MEMBER_4M EQU 21
CYDEV_CHIP_MEMBER_4N EQU 10
CYDEV_CHIP_MEMBER_4O EQU 7
CYDEV_CHIP_MEMBER_4P EQU 20
CYDEV_CHIP_MEMBER_4Q EQU 12
CYDEV_CHIP_MEMBER_4R EQU 8
CYDEV_CHIP_MEMBER_4S EQU 11
CYDEV_CHIP_MEMBER_4T EQU 9
CYDEV_CHIP_MEMBER_4U EQU 5
CYDEV_CHIP_MEMBER_4V EQU 16
CYDEV_CHIP_MEMBER_5A EQU 3
CYDEV_CHIP_MEMBER_5B EQU 2
CYDEV_CHIP_MEMBER_6A EQU 24
CYDEV_CHIP_MEMBER_FM3 EQU 28
CYDEV_CHIP_MEMBER_FM4 EQU 29
CYDEV_CHIP_MEMBER_PDL_FM0P_TYPE1 EQU 25
CYDEV_CHIP_MEMBER_PDL_FM0P_TYPE2 EQU 26
CYDEV_CHIP_MEMBER_PDL_FM0P_TYPE3 EQU 27
CYDEV_CHIP_MEMBER_UNKNOWN EQU 0
CYDEV_CHIP_MEMBER_USED EQU CYDEV_CHIP_MEMBER_5B
CYDEV_CHIP_DIE_EXPECT EQU CYDEV_CHIP_MEMBER_USED
CYDEV_CHIP_DIE_ACTUAL EQU CYDEV_CHIP_DIE_EXPECT
CYDEV_CHIP_REV_LEOPARD_ES1 EQU 0
CYDEV_CHIP_REV_LEOPARD_ES2 EQU 1
CYDEV_CHIP_REV_LEOPARD_ES3 EQU 3
CYDEV_CHIP_REV_LEOPARD_PRODUCTION EQU 3
CYDEV_CHIP_REV_PSOC4A_ES0 EQU 17
CYDEV_CHIP_REV_PSOC4A_PRODUCTION EQU 17
CYDEV_CHIP_REV_PSOC5LP_ES0 EQU 0
CYDEV_CHIP_REV_PSOC5LP_PRODUCTION EQU 0
CYDEV_CHIP_REV_PSOC5TM_ES0 EQU 0
CYDEV_CHIP_REV_PSOC5TM_ES1 EQU 1
CYDEV_CHIP_REV_PSOC5TM_PRODUCTION EQU 1
CYDEV_CHIP_REV_TMA4_ES EQU 17
CYDEV_CHIP_REV_TMA4_ES2 EQU 33
CYDEV_CHIP_REV_TMA4_PRODUCTION EQU 17
CYDEV_CHIP_REVISION_3A_ES1 EQU 0
CYDEV_CHIP_REVISION_3A_ES2 EQU 1
CYDEV_CHIP_REVISION_3A_ES3 EQU 3
CYDEV_CHIP_REVISION_3A_PRODUCTION EQU 3
CYDEV_CHIP_REVISION_4A_ES0 EQU 17
CYDEV_CHIP_REVISION_4A_PRODUCTION EQU 17
CYDEV_CHIP_REVISION_4D_PRODUCTION EQU 0
CYDEV_CHIP_REVISION_4E_CCG2_NO_USBPD EQU 0
CYDEV_CHIP_REVISION_4E_PRODUCTION EQU 0
CYDEV_CHIP_REVISION_4F_PRODUCTION EQU 0
CYDEV_CHIP_REVISION_4F_PRODUCTION_256DMA EQU 0
CYDEV_CHIP_REVISION_4F_PRODUCTION_256K EQU 0
CYDEV_CHIP_REVISION_4G_ES EQU 17
CYDEV_CHIP_REVISION_4G_ES2 EQU 33
CYDEV_CHIP_REVISION_4G_PRODUCTION EQU 17
CYDEV_CHIP_REVISION_4H_PRODUCTION EQU 0
CYDEV_CHIP_REVISION_4I_PRODUCTION EQU 0
CYDEV_CHIP_REVISION_4J_PRODUCTION EQU 0
CYDEV_CHIP_REVISION_4K_PRODUCTION EQU 0
CYDEV_CHIP_REVISION_4L_PRODUCTION EQU 0
CYDEV_CHIP_REVISION_4M_PRODUCTION EQU 0
CYDEV_CHIP_REVISION_4N_PRODUCTION EQU 0
CYDEV_CHIP_REVISION_4O_PRODUCTION EQU 0
CYDEV_CHIP_REVISION_4P_PRODUCTION EQU 0
CYDEV_CHIP_REVISION_4Q_PRODUCTION EQU 0
CYDEV_CHIP_REVISION_4R_PRODUCTION EQU 0
CYDEV_CHIP_REVISION_4S_PRODUCTION EQU 0
CYDEV_CHIP_REVISION_4T_PRODUCTION EQU 0
CYDEV_CHIP_REVISION_4U_PRODUCTION EQU 0
CYDEV_CHIP_REVISION_4V_PRODUCTION EQU 0
CYDEV_CHIP_REVISION_5A_ES0 EQU 0
CYDEV_CHIP_REVISION_5A_ES1 EQU 1
CYDEV_CHIP_REVISION_5A_PRODUCTION EQU 1
CYDEV_CHIP_REVISION_5B_ES0 EQU 0
CYDEV_CHIP_REVISION_5B_PRODUCTION EQU 0
CYDEV_CHIP_REVISION_6A_ES EQU 17
CYDEV_CHIP_REVISION_6A_NO_UDB EQU 33
CYDEV_CHIP_REVISION_6A_PRODUCTION EQU 33
CYDEV_CHIP_REVISION_FM3_PRODUCTION EQU 0
CYDEV_CHIP_REVISION_FM4_PRODUCTION EQU 0
CYDEV_CHIP_REVISION_PDL_FM0P_TYPE1_PRODUCTION EQU 0
CYDEV_CHIP_REVISION_PDL_FM0P_TYPE2_PRODUCTION EQU 0
CYDEV_CHIP_REVISION_PDL_FM0P_TYPE3_PRODUCTION EQU 0
CYDEV_CHIP_REVISION_USED EQU CYDEV_CHIP_REVISION_5B_PRODUCTION
CYDEV_CHIP_REV_EXPECT EQU CYDEV_CHIP_REVISION_USED
CYDEV_CONFIG_FASTBOOT_ENABLED EQU 1
CYDEV_CONFIG_UNUSED_IO_AllowButWarn EQU 0
CYDEV_CONFIG_UNUSED_IO EQU CYDEV_CONFIG_UNUSED_IO_AllowButWarn
CYDEV_CONFIG_UNUSED_IO_AllowWithInfo EQU 1
CYDEV_CONFIG_UNUSED_IO_Disallowed EQU 2
CYDEV_CONFIGURATION_COMPRESSED EQU 1
CYDEV_CONFIGURATION_DMA EQU 0
CYDEV_CONFIGURATION_ECC EQU 1
CYDEV_CONFIGURATION_IMOENABLED EQU CYDEV_CONFIG_FASTBOOT_ENABLED
CYDEV_CONFIGURATION_MODE_COMPRESSED EQU 0
CYDEV_CONFIGURATION_MODE EQU CYDEV_CONFIGURATION_MODE_COMPRESSED
CYDEV_CONFIGURATION_MODE_DMA EQU 2
CYDEV_CONFIGURATION_MODE_UNCOMPRESSED EQU 1
CYDEV_DEBUG_ENABLE_MASK EQU 0x20
CYDEV_DEBUG_ENABLE_REGISTER EQU CYREG_MLOGIC_DEBUG
CYDEV_DEBUGGING_DPS_Disable EQU 3
CYDEV_DEBUGGING_DPS_JTAG_4 EQU 1
CYDEV_DEBUGGING_DPS_JTAG_5 EQU 0
CYDEV_DEBUGGING_DPS_SWD EQU 2
CYDEV_DEBUGGING_DPS_SWD_SWV EQU 6
CYDEV_DEBUGGING_DPS EQU CYDEV_DEBUGGING_DPS_SWD_SWV
CYDEV_DEBUGGING_ENABLE EQU 1
CYDEV_DEBUGGING_XRES EQU 0
CYDEV_DMA_CHANNELS_AVAILABLE EQU 24
CYDEV_ECC_ENABLE EQU 0
CYDEV_HEAP_SIZE EQU 0x80
CYDEV_INSTRUCT_CACHE_ENABLED EQU 1
CYDEV_INTR_RISING EQU 0x0000000F
CYDEV_IS_EXPORTING_CODE EQU 0
CYDEV_IS_IMPORTING_CODE EQU 0
CYDEV_PROJ_TYPE EQU 0
CYDEV_PROJ_TYPE_BOOTLOADER EQU 1
CYDEV_PROJ_TYPE_LAUNCHER EQU 5
CYDEV_PROJ_TYPE_LOADABLE EQU 2
CYDEV_PROJ_TYPE_LOADABLEANDBOOTLOADER EQU 4
CYDEV_PROJ_TYPE_MULTIAPPBOOTLOADER EQU 3
CYDEV_PROJ_TYPE_STANDARD EQU 0
CYDEV_PROTECTION_ENABLE EQU 0
CYDEV_STACK_SIZE EQU 0x0800
CYDEV_USB_CLK_OSC_LOCKING_ENABLED_AT_PWR_UP EQU 1
CYDEV_USE_BUNDLED_CMSIS EQU 1
CYDEV_VARIABLE_VDDA EQU 0
CYDEV_VDDA_MV EQU 5000
CYDEV_VDDD_MV EQU 5000
CYDEV_VDDIO0_MV EQU 5000
CYDEV_VDDIO1_MV EQU 5000
CYDEV_VDDIO2_MV EQU 5000
CYDEV_VDDIO3_MV EQU 5000
CYDEV_VIO0_MV EQU 5000
CYDEV_VIO1_MV EQU 5000
CYDEV_VIO2_MV EQU 5000
CYDEV_VIO3_MV EQU 5000
CYIPBLOCK_ARM_CM3_VERSION EQU 0
CYIPBLOCK_P3_ANAIF_VERSION EQU 0
CYIPBLOCK_P3_CAN_VERSION EQU 0
CYIPBLOCK_P3_CAPSENSE_VERSION EQU 0
CYIPBLOCK_P3_COMP_VERSION EQU 0
CYIPBLOCK_P3_DECIMATOR_VERSION EQU 0
CYIPBLOCK_P3_DFB_VERSION EQU 0
CYIPBLOCK_P3_DMA_VERSION EQU 0
CYIPBLOCK_P3_DRQ_VERSION EQU 0
CYIPBLOCK_P3_DSM_VERSION EQU 0
CYIPBLOCK_P3_EMIF_VERSION EQU 0
CYIPBLOCK_P3_I2C_VERSION EQU 0
CYIPBLOCK_P3_LCD_VERSION EQU 0
CYIPBLOCK_P3_LPF_VERSION EQU 0
CYIPBLOCK_P3_OPAMP_VERSION EQU 0
CYIPBLOCK_P3_PM_VERSION EQU 0
CYIPBLOCK_P3_SCCT_VERSION EQU 0
CYIPBLOCK_P3_TIMER_VERSION EQU 0
CYIPBLOCK_P3_USB_VERSION EQU 0
CYIPBLOCK_P3_VIDAC_VERSION EQU 0
CYIPBLOCK_P3_VREF_VERSION EQU 0
CYIPBLOCK_S8_GPIO_VERSION EQU 0
CYIPBLOCK_S8_IRQ_VERSION EQU 0
CYIPBLOCK_S8_SAR_VERSION EQU 0
CYIPBLOCK_S8_SIO_VERSION EQU 0
CYIPBLOCK_S8_UDB_VERSION EQU 0
DMA_CHANNELS_USED__MASK0 EQU 0x00000003
CYDEV_BOOTLOADER_ENABLE EQU 0
    ENDIF
    END
