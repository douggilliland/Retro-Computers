/*******************************************************************************
* File Name: cyfittergnu.inc
* 
* PSoC Creator  4.2
*
* Description:
* 
* This file is automatically generated by PSoC Creator.
*
********************************************************************************
* Copyright (c) 2007-2018 Cypress Semiconductor.  All rights reserved.
* You may use this file only in accordance with the license, terms, conditions, 
* disclaimers, and limitations in the end user license agreement accompanying 
* the software package with which this file was provided.
********************************************************************************/

.ifndef INCLUDED_CYFITTERGNU_INC
.set INCLUDED_CYFITTERGNU_INC, 1
.include "cydevicegnu.inc"
.include "cydevicegnu_trm.inc"

/* CLK_5 */
.set CLK_5__0__INTTYPE, CYREG_PICU0_INTTYPE7
.set CLK_5__0__MASK, 0x80
.set CLK_5__0__PC, CYREG_PRT0_PC7
.set CLK_5__0__PORT, 0
.set CLK_5__0__SHIFT, 7
.set CLK_5__AG, CYREG_PRT0_AG
.set CLK_5__AMUX, CYREG_PRT0_AMUX
.set CLK_5__BIE, CYREG_PRT0_BIE
.set CLK_5__BIT_MASK, CYREG_PRT0_BIT_MASK
.set CLK_5__BYP, CYREG_PRT0_BYP
.set CLK_5__CTL, CYREG_PRT0_CTL
.set CLK_5__DM0, CYREG_PRT0_DM0
.set CLK_5__DM1, CYREG_PRT0_DM1
.set CLK_5__DM2, CYREG_PRT0_DM2
.set CLK_5__DR, CYREG_PRT0_DR
.set CLK_5__INP_DIS, CYREG_PRT0_INP_DIS
.set CLK_5__INTTYPE_BASE, CYDEV_PICU_INTTYPE_PICU0_BASE
.set CLK_5__LCD_COM_SEG, CYREG_PRT0_LCD_COM_SEG
.set CLK_5__LCD_EN, CYREG_PRT0_LCD_EN
.set CLK_5__MASK, 0x80
.set CLK_5__PORT, 0
.set CLK_5__PRT, CYREG_PRT0_PRT
.set CLK_5__PRTDSI__CAPS_SEL, CYREG_PRT0_CAPS_SEL
.set CLK_5__PRTDSI__DBL_SYNC_IN, CYREG_PRT0_DBL_SYNC_IN
.set CLK_5__PRTDSI__OE_SEL0, CYREG_PRT0_OE_SEL0
.set CLK_5__PRTDSI__OE_SEL1, CYREG_PRT0_OE_SEL1
.set CLK_5__PRTDSI__OUT_SEL0, CYREG_PRT0_OUT_SEL0
.set CLK_5__PRTDSI__OUT_SEL1, CYREG_PRT0_OUT_SEL1
.set CLK_5__PRTDSI__SYNC_OUT, CYREG_PRT0_SYNC_OUT
.set CLK_5__PS, CYREG_PRT0_PS
.set CLK_5__SHIFT, 7
.set CLK_5__SLW, CYREG_PRT0_SLW

/* CPU_A3 */
.set CPU_A3__0__INTTYPE, CYREG_PICU4_INTTYPE4
.set CPU_A3__0__MASK, 0x10
.set CPU_A3__0__PC, CYREG_PRT4_PC4
.set CPU_A3__0__PORT, 4
.set CPU_A3__0__SHIFT, 4
.set CPU_A3__AG, CYREG_PRT4_AG
.set CPU_A3__AMUX, CYREG_PRT4_AMUX
.set CPU_A3__BIE, CYREG_PRT4_BIE
.set CPU_A3__BIT_MASK, CYREG_PRT4_BIT_MASK
.set CPU_A3__BYP, CYREG_PRT4_BYP
.set CPU_A3__CTL, CYREG_PRT4_CTL
.set CPU_A3__DM0, CYREG_PRT4_DM0
.set CPU_A3__DM1, CYREG_PRT4_DM1
.set CPU_A3__DM2, CYREG_PRT4_DM2
.set CPU_A3__DR, CYREG_PRT4_DR
.set CPU_A3__INP_DIS, CYREG_PRT4_INP_DIS
.set CPU_A3__INTTYPE_BASE, CYDEV_PICU_INTTYPE_PICU4_BASE
.set CPU_A3__LCD_COM_SEG, CYREG_PRT4_LCD_COM_SEG
.set CPU_A3__LCD_EN, CYREG_PRT4_LCD_EN
.set CPU_A3__MASK, 0x10
.set CPU_A3__PORT, 4
.set CPU_A3__PRT, CYREG_PRT4_PRT
.set CPU_A3__PRTDSI__CAPS_SEL, CYREG_PRT4_CAPS_SEL
.set CPU_A3__PRTDSI__DBL_SYNC_IN, CYREG_PRT4_DBL_SYNC_IN
.set CPU_A3__PRTDSI__OE_SEL0, CYREG_PRT4_OE_SEL0
.set CPU_A3__PRTDSI__OE_SEL1, CYREG_PRT4_OE_SEL1
.set CPU_A3__PRTDSI__OUT_SEL0, CYREG_PRT4_OUT_SEL0
.set CPU_A3__PRTDSI__OUT_SEL1, CYREG_PRT4_OUT_SEL1
.set CPU_A3__PRTDSI__SYNC_OUT, CYREG_PRT4_SYNC_OUT
.set CPU_A3__PS, CYREG_PRT4_PS
.set CPU_A3__SHIFT, 4
.set CPU_A3__SLW, CYREG_PRT4_SLW

/* CPU_A4 */
.set CPU_A4__0__INTTYPE, CYREG_PICU2_INTTYPE7
.set CPU_A4__0__MASK, 0x80
.set CPU_A4__0__PC, CYREG_PRT2_PC7
.set CPU_A4__0__PORT, 2
.set CPU_A4__0__SHIFT, 7
.set CPU_A4__AG, CYREG_PRT2_AG
.set CPU_A4__AMUX, CYREG_PRT2_AMUX
.set CPU_A4__BIE, CYREG_PRT2_BIE
.set CPU_A4__BIT_MASK, CYREG_PRT2_BIT_MASK
.set CPU_A4__BYP, CYREG_PRT2_BYP
.set CPU_A4__CTL, CYREG_PRT2_CTL
.set CPU_A4__DM0, CYREG_PRT2_DM0
.set CPU_A4__DM1, CYREG_PRT2_DM1
.set CPU_A4__DM2, CYREG_PRT2_DM2
.set CPU_A4__DR, CYREG_PRT2_DR
.set CPU_A4__INP_DIS, CYREG_PRT2_INP_DIS
.set CPU_A4__INTTYPE_BASE, CYDEV_PICU_INTTYPE_PICU2_BASE
.set CPU_A4__LCD_COM_SEG, CYREG_PRT2_LCD_COM_SEG
.set CPU_A4__LCD_EN, CYREG_PRT2_LCD_EN
.set CPU_A4__MASK, 0x80
.set CPU_A4__PORT, 2
.set CPU_A4__PRT, CYREG_PRT2_PRT
.set CPU_A4__PRTDSI__CAPS_SEL, CYREG_PRT2_CAPS_SEL
.set CPU_A4__PRTDSI__DBL_SYNC_IN, CYREG_PRT2_DBL_SYNC_IN
.set CPU_A4__PRTDSI__OE_SEL0, CYREG_PRT2_OE_SEL0
.set CPU_A4__PRTDSI__OE_SEL1, CYREG_PRT2_OE_SEL1
.set CPU_A4__PRTDSI__OUT_SEL0, CYREG_PRT2_OUT_SEL0
.set CPU_A4__PRTDSI__OUT_SEL1, CYREG_PRT2_OUT_SEL1
.set CPU_A4__PRTDSI__SYNC_OUT, CYREG_PRT2_SYNC_OUT
.set CPU_A4__PS, CYREG_PRT2_PS
.set CPU_A4__SHIFT, 7
.set CPU_A4__SLW, CYREG_PRT2_SLW

/* CPU_A5 */
.set CPU_A5__0__INTTYPE, CYREG_PICU15_INTTYPE5
.set CPU_A5__0__MASK, 0x20
.set CPU_A5__0__PC, CYREG_IO_PC_PRT15_PC5
.set CPU_A5__0__PORT, 15
.set CPU_A5__0__SHIFT, 5
.set CPU_A5__AG, CYREG_PRT15_AG
.set CPU_A5__AMUX, CYREG_PRT15_AMUX
.set CPU_A5__BIE, CYREG_PRT15_BIE
.set CPU_A5__BIT_MASK, CYREG_PRT15_BIT_MASK
.set CPU_A5__BYP, CYREG_PRT15_BYP
.set CPU_A5__CTL, CYREG_PRT15_CTL
.set CPU_A5__DM0, CYREG_PRT15_DM0
.set CPU_A5__DM1, CYREG_PRT15_DM1
.set CPU_A5__DM2, CYREG_PRT15_DM2
.set CPU_A5__DR, CYREG_PRT15_DR
.set CPU_A5__INP_DIS, CYREG_PRT15_INP_DIS
.set CPU_A5__INTTYPE_BASE, CYDEV_PICU_INTTYPE_PICU15_BASE
.set CPU_A5__LCD_COM_SEG, CYREG_PRT15_LCD_COM_SEG
.set CPU_A5__LCD_EN, CYREG_PRT15_LCD_EN
.set CPU_A5__MASK, 0x20
.set CPU_A5__PORT, 15
.set CPU_A5__PRT, CYREG_PRT15_PRT
.set CPU_A5__PRTDSI__CAPS_SEL, CYREG_PRT15_CAPS_SEL
.set CPU_A5__PRTDSI__DBL_SYNC_IN, CYREG_PRT15_DBL_SYNC_IN
.set CPU_A5__PRTDSI__OE_SEL0, CYREG_PRT15_OE_SEL0
.set CPU_A5__PRTDSI__OE_SEL1, CYREG_PRT15_OE_SEL1
.set CPU_A5__PRTDSI__OUT_SEL0, CYREG_PRT15_OUT_SEL0
.set CPU_A5__PRTDSI__OUT_SEL1, CYREG_PRT15_OUT_SEL1
.set CPU_A5__PRTDSI__SYNC_OUT, CYREG_PRT15_SYNC_OUT
.set CPU_A5__PS, CYREG_PRT15_PS
.set CPU_A5__SHIFT, 5
.set CPU_A5__SLW, CYREG_PRT15_SLW

/* CPU_A6 */
.set CPU_A6__0__INTTYPE, CYREG_PICU2_INTTYPE3
.set CPU_A6__0__MASK, 0x08
.set CPU_A6__0__PC, CYREG_PRT2_PC3
.set CPU_A6__0__PORT, 2
.set CPU_A6__0__SHIFT, 3
.set CPU_A6__AG, CYREG_PRT2_AG
.set CPU_A6__AMUX, CYREG_PRT2_AMUX
.set CPU_A6__BIE, CYREG_PRT2_BIE
.set CPU_A6__BIT_MASK, CYREG_PRT2_BIT_MASK
.set CPU_A6__BYP, CYREG_PRT2_BYP
.set CPU_A6__CTL, CYREG_PRT2_CTL
.set CPU_A6__DM0, CYREG_PRT2_DM0
.set CPU_A6__DM1, CYREG_PRT2_DM1
.set CPU_A6__DM2, CYREG_PRT2_DM2
.set CPU_A6__DR, CYREG_PRT2_DR
.set CPU_A6__INP_DIS, CYREG_PRT2_INP_DIS
.set CPU_A6__INTTYPE_BASE, CYDEV_PICU_INTTYPE_PICU2_BASE
.set CPU_A6__LCD_COM_SEG, CYREG_PRT2_LCD_COM_SEG
.set CPU_A6__LCD_EN, CYREG_PRT2_LCD_EN
.set CPU_A6__MASK, 0x08
.set CPU_A6__PORT, 2
.set CPU_A6__PRT, CYREG_PRT2_PRT
.set CPU_A6__PRTDSI__CAPS_SEL, CYREG_PRT2_CAPS_SEL
.set CPU_A6__PRTDSI__DBL_SYNC_IN, CYREG_PRT2_DBL_SYNC_IN
.set CPU_A6__PRTDSI__OE_SEL0, CYREG_PRT2_OE_SEL0
.set CPU_A6__PRTDSI__OE_SEL1, CYREG_PRT2_OE_SEL1
.set CPU_A6__PRTDSI__OUT_SEL0, CYREG_PRT2_OUT_SEL0
.set CPU_A6__PRTDSI__OUT_SEL1, CYREG_PRT2_OUT_SEL1
.set CPU_A6__PRTDSI__SYNC_OUT, CYREG_PRT2_SYNC_OUT
.set CPU_A6__PS, CYREG_PRT2_PS
.set CPU_A6__SHIFT, 3
.set CPU_A6__SLW, CYREG_PRT2_SLW

/* CPU_A7 */
.set CPU_A7__0__INTTYPE, CYREG_PICU0_INTTYPE5
.set CPU_A7__0__MASK, 0x20
.set CPU_A7__0__PC, CYREG_PRT0_PC5
.set CPU_A7__0__PORT, 0
.set CPU_A7__0__SHIFT, 5
.set CPU_A7__AG, CYREG_PRT0_AG
.set CPU_A7__AMUX, CYREG_PRT0_AMUX
.set CPU_A7__BIE, CYREG_PRT0_BIE
.set CPU_A7__BIT_MASK, CYREG_PRT0_BIT_MASK
.set CPU_A7__BYP, CYREG_PRT0_BYP
.set CPU_A7__CTL, CYREG_PRT0_CTL
.set CPU_A7__DM0, CYREG_PRT0_DM0
.set CPU_A7__DM1, CYREG_PRT0_DM1
.set CPU_A7__DM2, CYREG_PRT0_DM2
.set CPU_A7__DR, CYREG_PRT0_DR
.set CPU_A7__INP_DIS, CYREG_PRT0_INP_DIS
.set CPU_A7__INTTYPE_BASE, CYDEV_PICU_INTTYPE_PICU0_BASE
.set CPU_A7__LCD_COM_SEG, CYREG_PRT0_LCD_COM_SEG
.set CPU_A7__LCD_EN, CYREG_PRT0_LCD_EN
.set CPU_A7__MASK, 0x20
.set CPU_A7__PORT, 0
.set CPU_A7__PRT, CYREG_PRT0_PRT
.set CPU_A7__PRTDSI__CAPS_SEL, CYREG_PRT0_CAPS_SEL
.set CPU_A7__PRTDSI__DBL_SYNC_IN, CYREG_PRT0_DBL_SYNC_IN
.set CPU_A7__PRTDSI__OE_SEL0, CYREG_PRT0_OE_SEL0
.set CPU_A7__PRTDSI__OE_SEL1, CYREG_PRT0_OE_SEL1
.set CPU_A7__PRTDSI__OUT_SEL0, CYREG_PRT0_OUT_SEL0
.set CPU_A7__PRTDSI__OUT_SEL1, CYREG_PRT0_OUT_SEL1
.set CPU_A7__PRTDSI__SYNC_OUT, CYREG_PRT0_SYNC_OUT
.set CPU_A7__PS, CYREG_PRT0_PS
.set CPU_A7__SHIFT, 5
.set CPU_A7__SLW, CYREG_PRT0_SLW

/* IOCS_n */
.set IOCS_n__0__INTTYPE, CYREG_PICU12_INTTYPE2
.set IOCS_n__0__MASK, 0x04
.set IOCS_n__0__PC, CYREG_PRT12_PC2
.set IOCS_n__0__PORT, 12
.set IOCS_n__0__SHIFT, 2
.set IOCS_n__AG, CYREG_PRT12_AG
.set IOCS_n__BIE, CYREG_PRT12_BIE
.set IOCS_n__BIT_MASK, CYREG_PRT12_BIT_MASK
.set IOCS_n__BYP, CYREG_PRT12_BYP
.set IOCS_n__DM0, CYREG_PRT12_DM0
.set IOCS_n__DM1, CYREG_PRT12_DM1
.set IOCS_n__DM2, CYREG_PRT12_DM2
.set IOCS_n__DR, CYREG_PRT12_DR
.set IOCS_n__INP_DIS, CYREG_PRT12_INP_DIS
.set IOCS_n__INTTYPE_BASE, CYDEV_PICU_INTTYPE_PICU12_BASE
.set IOCS_n__MASK, 0x04
.set IOCS_n__PORT, 12
.set IOCS_n__PRT, CYREG_PRT12_PRT
.set IOCS_n__PRTDSI__DBL_SYNC_IN, CYREG_PRT12_DBL_SYNC_IN
.set IOCS_n__PRTDSI__OE_SEL0, CYREG_PRT12_OE_SEL0
.set IOCS_n__PRTDSI__OE_SEL1, CYREG_PRT12_OE_SEL1
.set IOCS_n__PRTDSI__OUT_SEL0, CYREG_PRT12_OUT_SEL0
.set IOCS_n__PRTDSI__OUT_SEL1, CYREG_PRT12_OUT_SEL1
.set IOCS_n__PRTDSI__SYNC_OUT, CYREG_PRT12_SYNC_OUT
.set IOCS_n__PS, CYREG_PRT12_PS
.set IOCS_n__SHIFT, 2
.set IOCS_n__SIO_CFG, CYREG_PRT12_SIO_CFG
.set IOCS_n__SIO_DIFF, CYREG_PRT12_SIO_DIFF
.set IOCS_n__SIO_HYST_EN, CYREG_PRT12_SIO_HYST_EN
.set IOCS_n__SIO_REG_HIFREQ, CYREG_PRT12_SIO_REG_HIFREQ
.set IOCS_n__SLW, CYREG_PRT12_SLW

/* IORQ_n */
.set IORQ_n__0__INTTYPE, CYREG_PICU0_INTTYPE4
.set IORQ_n__0__MASK, 0x10
.set IORQ_n__0__PC, CYREG_PRT0_PC4
.set IORQ_n__0__PORT, 0
.set IORQ_n__0__SHIFT, 4
.set IORQ_n__AG, CYREG_PRT0_AG
.set IORQ_n__AMUX, CYREG_PRT0_AMUX
.set IORQ_n__BIE, CYREG_PRT0_BIE
.set IORQ_n__BIT_MASK, CYREG_PRT0_BIT_MASK
.set IORQ_n__BYP, CYREG_PRT0_BYP
.set IORQ_n__CTL, CYREG_PRT0_CTL
.set IORQ_n__DM0, CYREG_PRT0_DM0
.set IORQ_n__DM1, CYREG_PRT0_DM1
.set IORQ_n__DM2, CYREG_PRT0_DM2
.set IORQ_n__DR, CYREG_PRT0_DR
.set IORQ_n__INP_DIS, CYREG_PRT0_INP_DIS
.set IORQ_n__INTTYPE_BASE, CYDEV_PICU_INTTYPE_PICU0_BASE
.set IORQ_n__LCD_COM_SEG, CYREG_PRT0_LCD_COM_SEG
.set IORQ_n__LCD_EN, CYREG_PRT0_LCD_EN
.set IORQ_n__MASK, 0x10
.set IORQ_n__PORT, 0
.set IORQ_n__PRT, CYREG_PRT0_PRT
.set IORQ_n__PRTDSI__CAPS_SEL, CYREG_PRT0_CAPS_SEL
.set IORQ_n__PRTDSI__DBL_SYNC_IN, CYREG_PRT0_DBL_SYNC_IN
.set IORQ_n__PRTDSI__OE_SEL0, CYREG_PRT0_OE_SEL0
.set IORQ_n__PRTDSI__OE_SEL1, CYREG_PRT0_OE_SEL1
.set IORQ_n__PRTDSI__OUT_SEL0, CYREG_PRT0_OUT_SEL0
.set IORQ_n__PRTDSI__OUT_SEL1, CYREG_PRT0_OUT_SEL1
.set IORQ_n__PRTDSI__SYNC_OUT, CYREG_PRT0_SYNC_OUT
.set IORQ_n__PS, CYREG_PRT0_PS
.set IORQ_n__SHIFT, 4
.set IORQ_n__SLW, CYREG_PRT0_SLW

/* IOWR_n */
.set IOWR_n__0__INTTYPE, CYREG_PICU0_INTTYPE0
.set IOWR_n__0__MASK, 0x01
.set IOWR_n__0__PC, CYREG_PRT0_PC0
.set IOWR_n__0__PORT, 0
.set IOWR_n__0__SHIFT, 0
.set IOWR_n__AG, CYREG_PRT0_AG
.set IOWR_n__AMUX, CYREG_PRT0_AMUX
.set IOWR_n__BIE, CYREG_PRT0_BIE
.set IOWR_n__BIT_MASK, CYREG_PRT0_BIT_MASK
.set IOWR_n__BYP, CYREG_PRT0_BYP
.set IOWR_n__CTL, CYREG_PRT0_CTL
.set IOWR_n__DM0, CYREG_PRT0_DM0
.set IOWR_n__DM1, CYREG_PRT0_DM1
.set IOWR_n__DM2, CYREG_PRT0_DM2
.set IOWR_n__DR, CYREG_PRT0_DR
.set IOWR_n__INP_DIS, CYREG_PRT0_INP_DIS
.set IOWR_n__INTTYPE_BASE, CYDEV_PICU_INTTYPE_PICU0_BASE
.set IOWR_n__LCD_COM_SEG, CYREG_PRT0_LCD_COM_SEG
.set IOWR_n__LCD_EN, CYREG_PRT0_LCD_EN
.set IOWR_n__MASK, 0x01
.set IOWR_n__PORT, 0
.set IOWR_n__PRT, CYREG_PRT0_PRT
.set IOWR_n__PRTDSI__CAPS_SEL, CYREG_PRT0_CAPS_SEL
.set IOWR_n__PRTDSI__DBL_SYNC_IN, CYREG_PRT0_DBL_SYNC_IN
.set IOWR_n__PRTDSI__OE_SEL0, CYREG_PRT0_OE_SEL0
.set IOWR_n__PRTDSI__OE_SEL1, CYREG_PRT0_OE_SEL1
.set IOWR_n__PRTDSI__OUT_SEL0, CYREG_PRT0_OUT_SEL0
.set IOWR_n__PRTDSI__OUT_SEL1, CYREG_PRT0_OUT_SEL1
.set IOWR_n__PRTDSI__SYNC_OUT, CYREG_PRT0_SYNC_OUT
.set IOWR_n__PS, CYREG_PRT0_PS
.set IOWR_n__SHIFT, 0
.set IOWR_n__SLW, CYREG_PRT0_SLW

/* MREQ_n */
.set MREQ_n__0__INTTYPE, CYREG_PICU0_INTTYPE2
.set MREQ_n__0__MASK, 0x04
.set MREQ_n__0__PC, CYREG_PRT0_PC2
.set MREQ_n__0__PORT, 0
.set MREQ_n__0__SHIFT, 2
.set MREQ_n__AG, CYREG_PRT0_AG
.set MREQ_n__AMUX, CYREG_PRT0_AMUX
.set MREQ_n__BIE, CYREG_PRT0_BIE
.set MREQ_n__BIT_MASK, CYREG_PRT0_BIT_MASK
.set MREQ_n__BYP, CYREG_PRT0_BYP
.set MREQ_n__CTL, CYREG_PRT0_CTL
.set MREQ_n__DM0, CYREG_PRT0_DM0
.set MREQ_n__DM1, CYREG_PRT0_DM1
.set MREQ_n__DM2, CYREG_PRT0_DM2
.set MREQ_n__DR, CYREG_PRT0_DR
.set MREQ_n__INP_DIS, CYREG_PRT0_INP_DIS
.set MREQ_n__INTTYPE_BASE, CYDEV_PICU_INTTYPE_PICU0_BASE
.set MREQ_n__LCD_COM_SEG, CYREG_PRT0_LCD_COM_SEG
.set MREQ_n__LCD_EN, CYREG_PRT0_LCD_EN
.set MREQ_n__MASK, 0x04
.set MREQ_n__PORT, 0
.set MREQ_n__PRT, CYREG_PRT0_PRT
.set MREQ_n__PRTDSI__CAPS_SEL, CYREG_PRT0_CAPS_SEL
.set MREQ_n__PRTDSI__DBL_SYNC_IN, CYREG_PRT0_DBL_SYNC_IN
.set MREQ_n__PRTDSI__OE_SEL0, CYREG_PRT0_OE_SEL0
.set MREQ_n__PRTDSI__OE_SEL1, CYREG_PRT0_OE_SEL1
.set MREQ_n__PRTDSI__OUT_SEL0, CYREG_PRT0_OUT_SEL0
.set MREQ_n__PRTDSI__OUT_SEL1, CYREG_PRT0_OUT_SEL1
.set MREQ_n__PRTDSI__SYNC_OUT, CYREG_PRT0_SYNC_OUT
.set MREQ_n__PS, CYREG_PRT0_PS
.set MREQ_n__SHIFT, 2
.set MREQ_n__SLW, CYREG_PRT0_SLW

/* CPU_A14 */
.set CPU_A14__0__INTTYPE, CYREG_PICU0_INTTYPE3
.set CPU_A14__0__MASK, 0x08
.set CPU_A14__0__PC, CYREG_PRT0_PC3
.set CPU_A14__0__PORT, 0
.set CPU_A14__0__SHIFT, 3
.set CPU_A14__AG, CYREG_PRT0_AG
.set CPU_A14__AMUX, CYREG_PRT0_AMUX
.set CPU_A14__BIE, CYREG_PRT0_BIE
.set CPU_A14__BIT_MASK, CYREG_PRT0_BIT_MASK
.set CPU_A14__BYP, CYREG_PRT0_BYP
.set CPU_A14__CTL, CYREG_PRT0_CTL
.set CPU_A14__DM0, CYREG_PRT0_DM0
.set CPU_A14__DM1, CYREG_PRT0_DM1
.set CPU_A14__DM2, CYREG_PRT0_DM2
.set CPU_A14__DR, CYREG_PRT0_DR
.set CPU_A14__INP_DIS, CYREG_PRT0_INP_DIS
.set CPU_A14__INTTYPE_BASE, CYDEV_PICU_INTTYPE_PICU0_BASE
.set CPU_A14__LCD_COM_SEG, CYREG_PRT0_LCD_COM_SEG
.set CPU_A14__LCD_EN, CYREG_PRT0_LCD_EN
.set CPU_A14__MASK, 0x08
.set CPU_A14__PORT, 0
.set CPU_A14__PRT, CYREG_PRT0_PRT
.set CPU_A14__PRTDSI__CAPS_SEL, CYREG_PRT0_CAPS_SEL
.set CPU_A14__PRTDSI__DBL_SYNC_IN, CYREG_PRT0_DBL_SYNC_IN
.set CPU_A14__PRTDSI__OE_SEL0, CYREG_PRT0_OE_SEL0
.set CPU_A14__PRTDSI__OE_SEL1, CYREG_PRT0_OE_SEL1
.set CPU_A14__PRTDSI__OUT_SEL0, CYREG_PRT0_OUT_SEL0
.set CPU_A14__PRTDSI__OUT_SEL1, CYREG_PRT0_OUT_SEL1
.set CPU_A14__PRTDSI__SYNC_OUT, CYREG_PRT0_SYNC_OUT
.set CPU_A14__PS, CYREG_PRT0_PS
.set CPU_A14__SHIFT, 3
.set CPU_A14__SLW, CYREG_PRT0_SLW

/* CPU_A15 */
.set CPU_A15__0__INTTYPE, CYREG_PICU0_INTTYPE6
.set CPU_A15__0__MASK, 0x40
.set CPU_A15__0__PC, CYREG_PRT0_PC6
.set CPU_A15__0__PORT, 0
.set CPU_A15__0__SHIFT, 6
.set CPU_A15__AG, CYREG_PRT0_AG
.set CPU_A15__AMUX, CYREG_PRT0_AMUX
.set CPU_A15__BIE, CYREG_PRT0_BIE
.set CPU_A15__BIT_MASK, CYREG_PRT0_BIT_MASK
.set CPU_A15__BYP, CYREG_PRT0_BYP
.set CPU_A15__CTL, CYREG_PRT0_CTL
.set CPU_A15__DM0, CYREG_PRT0_DM0
.set CPU_A15__DM1, CYREG_PRT0_DM1
.set CPU_A15__DM2, CYREG_PRT0_DM2
.set CPU_A15__DR, CYREG_PRT0_DR
.set CPU_A15__INP_DIS, CYREG_PRT0_INP_DIS
.set CPU_A15__INTTYPE_BASE, CYDEV_PICU_INTTYPE_PICU0_BASE
.set CPU_A15__LCD_COM_SEG, CYREG_PRT0_LCD_COM_SEG
.set CPU_A15__LCD_EN, CYREG_PRT0_LCD_EN
.set CPU_A15__MASK, 0x40
.set CPU_A15__PORT, 0
.set CPU_A15__PRT, CYREG_PRT0_PRT
.set CPU_A15__PRTDSI__CAPS_SEL, CYREG_PRT0_CAPS_SEL
.set CPU_A15__PRTDSI__DBL_SYNC_IN, CYREG_PRT0_DBL_SYNC_IN
.set CPU_A15__PRTDSI__OE_SEL0, CYREG_PRT0_OE_SEL0
.set CPU_A15__PRTDSI__OE_SEL1, CYREG_PRT0_OE_SEL1
.set CPU_A15__PRTDSI__OUT_SEL0, CYREG_PRT0_OUT_SEL0
.set CPU_A15__PRTDSI__OUT_SEL1, CYREG_PRT0_OUT_SEL1
.set CPU_A15__PRTDSI__SYNC_OUT, CYREG_PRT0_SYNC_OUT
.set CPU_A15__PS, CYREG_PRT0_PS
.set CPU_A15__SHIFT, 6
.set CPU_A15__SLW, CYREG_PRT0_SLW

/* CPU_CLK */
.set CPU_CLK__0__INTTYPE, CYREG_PICU0_INTTYPE1
.set CPU_CLK__0__MASK, 0x02
.set CPU_CLK__0__PC, CYREG_PRT0_PC1
.set CPU_CLK__0__PORT, 0
.set CPU_CLK__0__SHIFT, 1
.set CPU_CLK__AG, CYREG_PRT0_AG
.set CPU_CLK__AMUX, CYREG_PRT0_AMUX
.set CPU_CLK__BIE, CYREG_PRT0_BIE
.set CPU_CLK__BIT_MASK, CYREG_PRT0_BIT_MASK
.set CPU_CLK__BYP, CYREG_PRT0_BYP
.set CPU_CLK__CTL, CYREG_PRT0_CTL
.set CPU_CLK__DM0, CYREG_PRT0_DM0
.set CPU_CLK__DM1, CYREG_PRT0_DM1
.set CPU_CLK__DM2, CYREG_PRT0_DM2
.set CPU_CLK__DR, CYREG_PRT0_DR
.set CPU_CLK__INP_DIS, CYREG_PRT0_INP_DIS
.set CPU_CLK__INTTYPE_BASE, CYDEV_PICU_INTTYPE_PICU0_BASE
.set CPU_CLK__LCD_COM_SEG, CYREG_PRT0_LCD_COM_SEG
.set CPU_CLK__LCD_EN, CYREG_PRT0_LCD_EN
.set CPU_CLK__MASK, 0x02
.set CPU_CLK__PORT, 0
.set CPU_CLK__PRT, CYREG_PRT0_PRT
.set CPU_CLK__PRTDSI__CAPS_SEL, CYREG_PRT0_CAPS_SEL
.set CPU_CLK__PRTDSI__DBL_SYNC_IN, CYREG_PRT0_DBL_SYNC_IN
.set CPU_CLK__PRTDSI__OE_SEL0, CYREG_PRT0_OE_SEL0
.set CPU_CLK__PRTDSI__OE_SEL1, CYREG_PRT0_OE_SEL1
.set CPU_CLK__PRTDSI__OUT_SEL0, CYREG_PRT0_OUT_SEL0
.set CPU_CLK__PRTDSI__OUT_SEL1, CYREG_PRT0_OUT_SEL1
.set CPU_CLK__PRTDSI__SYNC_OUT, CYREG_PRT0_SYNC_OUT
.set CPU_CLK__PS, CYREG_PRT0_PS
.set CPU_CLK__SHIFT, 1
.set CPU_CLK__SLW, CYREG_PRT0_SLW

/* Clock_1 */
.set Clock_1__CFG0, CYREG_CLKDIST_DCFG0_CFG0
.set Clock_1__CFG1, CYREG_CLKDIST_DCFG0_CFG1
.set Clock_1__CFG2, CYREG_CLKDIST_DCFG0_CFG2
.set Clock_1__CFG2_SRC_SEL_MASK, 0x07
.set Clock_1__INDEX, 0x00
.set Clock_1__PM_ACT_CFG, CYREG_PM_ACT_CFG2
.set Clock_1__PM_ACT_MSK, 0x01
.set Clock_1__PM_STBY_CFG, CYREG_PM_STBY_CFG2
.set Clock_1__PM_STBY_MSK, 0x01

/* EEPCS_n */
.set EEPCS_n__0__INTTYPE, CYREG_PICU2_INTTYPE0
.set EEPCS_n__0__MASK, 0x01
.set EEPCS_n__0__PC, CYREG_PRT2_PC0
.set EEPCS_n__0__PORT, 2
.set EEPCS_n__0__SHIFT, 0
.set EEPCS_n__AG, CYREG_PRT2_AG
.set EEPCS_n__AMUX, CYREG_PRT2_AMUX
.set EEPCS_n__BIE, CYREG_PRT2_BIE
.set EEPCS_n__BIT_MASK, CYREG_PRT2_BIT_MASK
.set EEPCS_n__BYP, CYREG_PRT2_BYP
.set EEPCS_n__CTL, CYREG_PRT2_CTL
.set EEPCS_n__DM0, CYREG_PRT2_DM0
.set EEPCS_n__DM1, CYREG_PRT2_DM1
.set EEPCS_n__DM2, CYREG_PRT2_DM2
.set EEPCS_n__DR, CYREG_PRT2_DR
.set EEPCS_n__INP_DIS, CYREG_PRT2_INP_DIS
.set EEPCS_n__INTTYPE_BASE, CYDEV_PICU_INTTYPE_PICU2_BASE
.set EEPCS_n__LCD_COM_SEG, CYREG_PRT2_LCD_COM_SEG
.set EEPCS_n__LCD_EN, CYREG_PRT2_LCD_EN
.set EEPCS_n__MASK, 0x01
.set EEPCS_n__PORT, 2
.set EEPCS_n__PRT, CYREG_PRT2_PRT
.set EEPCS_n__PRTDSI__CAPS_SEL, CYREG_PRT2_CAPS_SEL
.set EEPCS_n__PRTDSI__DBL_SYNC_IN, CYREG_PRT2_DBL_SYNC_IN
.set EEPCS_n__PRTDSI__OE_SEL0, CYREG_PRT2_OE_SEL0
.set EEPCS_n__PRTDSI__OE_SEL1, CYREG_PRT2_OE_SEL1
.set EEPCS_n__PRTDSI__OUT_SEL0, CYREG_PRT2_OUT_SEL0
.set EEPCS_n__PRTDSI__OUT_SEL1, CYREG_PRT2_OUT_SEL1
.set EEPCS_n__PRTDSI__SYNC_OUT, CYREG_PRT2_SYNC_OUT
.set EEPCS_n__PS, CYREG_PRT2_PS
.set EEPCS_n__SHIFT, 0
.set EEPCS_n__SLW, CYREG_PRT2_SLW

/* SIOCS_n */
.set SIOCS_n__0__INTTYPE, CYREG_PICU2_INTTYPE1
.set SIOCS_n__0__MASK, 0x02
.set SIOCS_n__0__PC, CYREG_PRT2_PC1
.set SIOCS_n__0__PORT, 2
.set SIOCS_n__0__SHIFT, 1
.set SIOCS_n__AG, CYREG_PRT2_AG
.set SIOCS_n__AMUX, CYREG_PRT2_AMUX
.set SIOCS_n__BIE, CYREG_PRT2_BIE
.set SIOCS_n__BIT_MASK, CYREG_PRT2_BIT_MASK
.set SIOCS_n__BYP, CYREG_PRT2_BYP
.set SIOCS_n__CTL, CYREG_PRT2_CTL
.set SIOCS_n__DM0, CYREG_PRT2_DM0
.set SIOCS_n__DM1, CYREG_PRT2_DM1
.set SIOCS_n__DM2, CYREG_PRT2_DM2
.set SIOCS_n__DR, CYREG_PRT2_DR
.set SIOCS_n__INP_DIS, CYREG_PRT2_INP_DIS
.set SIOCS_n__INTTYPE_BASE, CYDEV_PICU_INTTYPE_PICU2_BASE
.set SIOCS_n__LCD_COM_SEG, CYREG_PRT2_LCD_COM_SEG
.set SIOCS_n__LCD_EN, CYREG_PRT2_LCD_EN
.set SIOCS_n__MASK, 0x02
.set SIOCS_n__PORT, 2
.set SIOCS_n__PRT, CYREG_PRT2_PRT
.set SIOCS_n__PRTDSI__CAPS_SEL, CYREG_PRT2_CAPS_SEL
.set SIOCS_n__PRTDSI__DBL_SYNC_IN, CYREG_PRT2_DBL_SYNC_IN
.set SIOCS_n__PRTDSI__OE_SEL0, CYREG_PRT2_OE_SEL0
.set SIOCS_n__PRTDSI__OE_SEL1, CYREG_PRT2_OE_SEL1
.set SIOCS_n__PRTDSI__OUT_SEL0, CYREG_PRT2_OUT_SEL0
.set SIOCS_n__PRTDSI__OUT_SEL1, CYREG_PRT2_OUT_SEL1
.set SIOCS_n__PRTDSI__SYNC_OUT, CYREG_PRT2_SYNC_OUT
.set SIOCS_n__PS, CYREG_PRT2_PS
.set SIOCS_n__SHIFT, 1
.set SIOCS_n__SLW, CYREG_PRT2_SLW

/* CRESET_n */
.set CRESET_n__0__INTTYPE, CYREG_PICU1_INTTYPE6
.set CRESET_n__0__MASK, 0x40
.set CRESET_n__0__PC, CYREG_PRT1_PC6
.set CRESET_n__0__PORT, 1
.set CRESET_n__0__SHIFT, 6
.set CRESET_n__AG, CYREG_PRT1_AG
.set CRESET_n__AMUX, CYREG_PRT1_AMUX
.set CRESET_n__BIE, CYREG_PRT1_BIE
.set CRESET_n__BIT_MASK, CYREG_PRT1_BIT_MASK
.set CRESET_n__BYP, CYREG_PRT1_BYP
.set CRESET_n__CTL, CYREG_PRT1_CTL
.set CRESET_n__DM0, CYREG_PRT1_DM0
.set CRESET_n__DM1, CYREG_PRT1_DM1
.set CRESET_n__DM2, CYREG_PRT1_DM2
.set CRESET_n__DR, CYREG_PRT1_DR
.set CRESET_n__INP_DIS, CYREG_PRT1_INP_DIS
.set CRESET_n__INTTYPE_BASE, CYDEV_PICU_INTTYPE_PICU1_BASE
.set CRESET_n__LCD_COM_SEG, CYREG_PRT1_LCD_COM_SEG
.set CRESET_n__LCD_EN, CYREG_PRT1_LCD_EN
.set CRESET_n__MASK, 0x40
.set CRESET_n__PORT, 1
.set CRESET_n__PRT, CYREG_PRT1_PRT
.set CRESET_n__PRTDSI__CAPS_SEL, CYREG_PRT1_CAPS_SEL
.set CRESET_n__PRTDSI__DBL_SYNC_IN, CYREG_PRT1_DBL_SYNC_IN
.set CRESET_n__PRTDSI__OE_SEL0, CYREG_PRT1_OE_SEL0
.set CRESET_n__PRTDSI__OE_SEL1, CYREG_PRT1_OE_SEL1
.set CRESET_n__PRTDSI__OUT_SEL0, CYREG_PRT1_OUT_SEL0
.set CRESET_n__PRTDSI__OUT_SEL1, CYREG_PRT1_OUT_SEL1
.set CRESET_n__PRTDSI__SYNC_OUT, CYREG_PRT1_SYNC_OUT
.set CRESET_n__PS, CYREG_PRT1_PS
.set CRESET_n__SHIFT, 6
.set CRESET_n__SLW, CYREG_PRT1_SLW

/* MAIN_CLK */
.set MAIN_CLK__CFG0, CYREG_CLKDIST_DCFG1_CFG0
.set MAIN_CLK__CFG1, CYREG_CLKDIST_DCFG1_CFG1
.set MAIN_CLK__CFG2, CYREG_CLKDIST_DCFG1_CFG2
.set MAIN_CLK__CFG2_SRC_SEL_MASK, 0x07
.set MAIN_CLK__INDEX, 0x01
.set MAIN_CLK__PM_ACT_CFG, CYREG_PM_ACT_CFG2
.set MAIN_CLK__PM_ACT_MSK, 0x02
.set MAIN_CLK__PM_STBY_CFG, CYREG_PM_STBY_CFG2
.set MAIN_CLK__PM_STBY_MSK, 0x02

/* WRESET_n */
.set WRESET_n__0__INTTYPE, CYREG_PICU15_INTTYPE4
.set WRESET_n__0__MASK, 0x10
.set WRESET_n__0__PC, CYREG_IO_PC_PRT15_PC4
.set WRESET_n__0__PORT, 15
.set WRESET_n__0__SHIFT, 4
.set WRESET_n__AG, CYREG_PRT15_AG
.set WRESET_n__AMUX, CYREG_PRT15_AMUX
.set WRESET_n__BIE, CYREG_PRT15_BIE
.set WRESET_n__BIT_MASK, CYREG_PRT15_BIT_MASK
.set WRESET_n__BYP, CYREG_PRT15_BYP
.set WRESET_n__CTL, CYREG_PRT15_CTL
.set WRESET_n__DM0, CYREG_PRT15_DM0
.set WRESET_n__DM1, CYREG_PRT15_DM1
.set WRESET_n__DM2, CYREG_PRT15_DM2
.set WRESET_n__DR, CYREG_PRT15_DR
.set WRESET_n__INP_DIS, CYREG_PRT15_INP_DIS
.set WRESET_n__INTTYPE_BASE, CYDEV_PICU_INTTYPE_PICU15_BASE
.set WRESET_n__LCD_COM_SEG, CYREG_PRT15_LCD_COM_SEG
.set WRESET_n__LCD_EN, CYREG_PRT15_LCD_EN
.set WRESET_n__MASK, 0x10
.set WRESET_n__PORT, 15
.set WRESET_n__PRT, CYREG_PRT15_PRT
.set WRESET_n__PRTDSI__CAPS_SEL, CYREG_PRT15_CAPS_SEL
.set WRESET_n__PRTDSI__DBL_SYNC_IN, CYREG_PRT15_DBL_SYNC_IN
.set WRESET_n__PRTDSI__OE_SEL0, CYREG_PRT15_OE_SEL0
.set WRESET_n__PRTDSI__OE_SEL1, CYREG_PRT15_OE_SEL1
.set WRESET_n__PRTDSI__OUT_SEL0, CYREG_PRT15_OUT_SEL0
.set WRESET_n__PRTDSI__OUT_SEL1, CYREG_PRT15_OUT_SEL1
.set WRESET_n__PRTDSI__SYNC_OUT, CYREG_PRT15_SYNC_OUT
.set WRESET_n__PS, CYREG_PRT15_PS
.set WRESET_n__SHIFT, 4
.set WRESET_n__SLW, CYREG_PRT15_SLW

/* SRAMCS1_n */
.set SRAMCS1_n__0__INTTYPE, CYREG_PICU2_INTTYPE2
.set SRAMCS1_n__0__MASK, 0x04
.set SRAMCS1_n__0__PC, CYREG_PRT2_PC2
.set SRAMCS1_n__0__PORT, 2
.set SRAMCS1_n__0__SHIFT, 2
.set SRAMCS1_n__AG, CYREG_PRT2_AG
.set SRAMCS1_n__AMUX, CYREG_PRT2_AMUX
.set SRAMCS1_n__BIE, CYREG_PRT2_BIE
.set SRAMCS1_n__BIT_MASK, CYREG_PRT2_BIT_MASK
.set SRAMCS1_n__BYP, CYREG_PRT2_BYP
.set SRAMCS1_n__CTL, CYREG_PRT2_CTL
.set SRAMCS1_n__DM0, CYREG_PRT2_DM0
.set SRAMCS1_n__DM1, CYREG_PRT2_DM1
.set SRAMCS1_n__DM2, CYREG_PRT2_DM2
.set SRAMCS1_n__DR, CYREG_PRT2_DR
.set SRAMCS1_n__INP_DIS, CYREG_PRT2_INP_DIS
.set SRAMCS1_n__INTTYPE_BASE, CYDEV_PICU_INTTYPE_PICU2_BASE
.set SRAMCS1_n__LCD_COM_SEG, CYREG_PRT2_LCD_COM_SEG
.set SRAMCS1_n__LCD_EN, CYREG_PRT2_LCD_EN
.set SRAMCS1_n__MASK, 0x04
.set SRAMCS1_n__PORT, 2
.set SRAMCS1_n__PRT, CYREG_PRT2_PRT
.set SRAMCS1_n__PRTDSI__CAPS_SEL, CYREG_PRT2_CAPS_SEL
.set SRAMCS1_n__PRTDSI__DBL_SYNC_IN, CYREG_PRT2_DBL_SYNC_IN
.set SRAMCS1_n__PRTDSI__OE_SEL0, CYREG_PRT2_OE_SEL0
.set SRAMCS1_n__PRTDSI__OE_SEL1, CYREG_PRT2_OE_SEL1
.set SRAMCS1_n__PRTDSI__OUT_SEL0, CYREG_PRT2_OUT_SEL0
.set SRAMCS1_n__PRTDSI__OUT_SEL1, CYREG_PRT2_OUT_SEL1
.set SRAMCS1_n__PRTDSI__SYNC_OUT, CYREG_PRT2_SYNC_OUT
.set SRAMCS1_n__PS, CYREG_PRT2_PS
.set SRAMCS1_n__SHIFT, 2
.set SRAMCS1_n__SLW, CYREG_PRT2_SLW

/* SRAMCS2_n */
.set SRAMCS2_n__0__INTTYPE, CYREG_PICU2_INTTYPE4
.set SRAMCS2_n__0__MASK, 0x10
.set SRAMCS2_n__0__PC, CYREG_PRT2_PC4
.set SRAMCS2_n__0__PORT, 2
.set SRAMCS2_n__0__SHIFT, 4
.set SRAMCS2_n__AG, CYREG_PRT2_AG
.set SRAMCS2_n__AMUX, CYREG_PRT2_AMUX
.set SRAMCS2_n__BIE, CYREG_PRT2_BIE
.set SRAMCS2_n__BIT_MASK, CYREG_PRT2_BIT_MASK
.set SRAMCS2_n__BYP, CYREG_PRT2_BYP
.set SRAMCS2_n__CTL, CYREG_PRT2_CTL
.set SRAMCS2_n__DM0, CYREG_PRT2_DM0
.set SRAMCS2_n__DM1, CYREG_PRT2_DM1
.set SRAMCS2_n__DM2, CYREG_PRT2_DM2
.set SRAMCS2_n__DR, CYREG_PRT2_DR
.set SRAMCS2_n__INP_DIS, CYREG_PRT2_INP_DIS
.set SRAMCS2_n__INTTYPE_BASE, CYDEV_PICU_INTTYPE_PICU2_BASE
.set SRAMCS2_n__LCD_COM_SEG, CYREG_PRT2_LCD_COM_SEG
.set SRAMCS2_n__LCD_EN, CYREG_PRT2_LCD_EN
.set SRAMCS2_n__MASK, 0x10
.set SRAMCS2_n__PORT, 2
.set SRAMCS2_n__PRT, CYREG_PRT2_PRT
.set SRAMCS2_n__PRTDSI__CAPS_SEL, CYREG_PRT2_CAPS_SEL
.set SRAMCS2_n__PRTDSI__DBL_SYNC_IN, CYREG_PRT2_DBL_SYNC_IN
.set SRAMCS2_n__PRTDSI__OE_SEL0, CYREG_PRT2_OE_SEL0
.set SRAMCS2_n__PRTDSI__OE_SEL1, CYREG_PRT2_OE_SEL1
.set SRAMCS2_n__PRTDSI__OUT_SEL0, CYREG_PRT2_OUT_SEL0
.set SRAMCS2_n__PRTDSI__OUT_SEL1, CYREG_PRT2_OUT_SEL1
.set SRAMCS2_n__PRTDSI__SYNC_OUT, CYREG_PRT2_SYNC_OUT
.set SRAMCS2_n__PS, CYREG_PRT2_PS
.set SRAMCS2_n__SHIFT, 4
.set SRAMCS2_n__SLW, CYREG_PRT2_SLW

/* RESET_CTRL_REG */
.set RESET_CTRL_REG_Sync_ctrl_reg__0__MASK, 0x01
.set RESET_CTRL_REG_Sync_ctrl_reg__0__POS, 0
.set RESET_CTRL_REG_Sync_ctrl_reg__1__MASK, 0x02
.set RESET_CTRL_REG_Sync_ctrl_reg__1__POS, 1
.set RESET_CTRL_REG_Sync_ctrl_reg__16BIT_CONTROL_AUX_CTL_REG, CYREG_B0_UDB04_05_ACTL
.set RESET_CTRL_REG_Sync_ctrl_reg__16BIT_CONTROL_CONTROL_REG, CYREG_B0_UDB04_05_CTL
.set RESET_CTRL_REG_Sync_ctrl_reg__16BIT_CONTROL_COUNT_REG, CYREG_B0_UDB04_05_CTL
.set RESET_CTRL_REG_Sync_ctrl_reg__16BIT_COUNT_CONTROL_REG, CYREG_B0_UDB04_05_CTL
.set RESET_CTRL_REG_Sync_ctrl_reg__16BIT_COUNT_COUNT_REG, CYREG_B0_UDB04_05_CTL
.set RESET_CTRL_REG_Sync_ctrl_reg__16BIT_MASK_MASK_REG, CYREG_B0_UDB04_05_MSK
.set RESET_CTRL_REG_Sync_ctrl_reg__16BIT_MASK_PERIOD_REG, CYREG_B0_UDB04_05_MSK
.set RESET_CTRL_REG_Sync_ctrl_reg__16BIT_PERIOD_MASK_REG, CYREG_B0_UDB04_05_MSK
.set RESET_CTRL_REG_Sync_ctrl_reg__16BIT_PERIOD_PERIOD_REG, CYREG_B0_UDB04_05_MSK
.set RESET_CTRL_REG_Sync_ctrl_reg__CONTROL_AUX_CTL_REG, CYREG_B0_UDB04_ACTL
.set RESET_CTRL_REG_Sync_ctrl_reg__CONTROL_REG, CYREG_B0_UDB04_CTL
.set RESET_CTRL_REG_Sync_ctrl_reg__CONTROL_ST_REG, CYREG_B0_UDB04_ST_CTL
.set RESET_CTRL_REG_Sync_ctrl_reg__COUNT_REG, CYREG_B0_UDB04_CTL
.set RESET_CTRL_REG_Sync_ctrl_reg__COUNT_ST_REG, CYREG_B0_UDB04_ST_CTL
.set RESET_CTRL_REG_Sync_ctrl_reg__MASK, 0x03
.set RESET_CTRL_REG_Sync_ctrl_reg__MASK_CTL_AUX_CTL_REG, CYREG_B0_UDB04_MSK_ACTL
.set RESET_CTRL_REG_Sync_ctrl_reg__PER_CTL_AUX_CTL_REG, CYREG_B0_UDB04_MSK_ACTL
.set RESET_CTRL_REG_Sync_ctrl_reg__PERIOD_REG, CYREG_B0_UDB04_MSK

/* Miscellaneous */
.set BCLK__BUS_CLK__HZ, 66352499
.set BCLK__BUS_CLK__KHZ, 66352
.set BCLK__BUS_CLK__MHZ, 66
.set CYDEV_CHIP_DIE_LEOPARD, 1
.set CYDEV_CHIP_DIE_PSOC4A, 18
.set CYDEV_CHIP_DIE_PSOC5LP, 2
.set CYDEV_CHIP_DIE_PSOC5TM, 3
.set CYDEV_CHIP_DIE_TMA4, 4
.set CYDEV_CHIP_DIE_UNKNOWN, 0
.set CYDEV_CHIP_FAMILY_FM0P, 5
.set CYDEV_CHIP_FAMILY_FM3, 6
.set CYDEV_CHIP_FAMILY_FM4, 7
.set CYDEV_CHIP_FAMILY_PSOC3, 1
.set CYDEV_CHIP_FAMILY_PSOC4, 2
.set CYDEV_CHIP_FAMILY_PSOC5, 3
.set CYDEV_CHIP_FAMILY_PSOC6, 4
.set CYDEV_CHIP_FAMILY_UNKNOWN, 0
.set CYDEV_CHIP_FAMILY_USED, CYDEV_CHIP_FAMILY_PSOC5
.set CYDEV_CHIP_JTAG_ID, 0x2E133069
.set CYDEV_CHIP_MEMBER_3A, 1
.set CYDEV_CHIP_MEMBER_4A, 18
.set CYDEV_CHIP_MEMBER_4D, 13
.set CYDEV_CHIP_MEMBER_4E, 6
.set CYDEV_CHIP_MEMBER_4F, 19
.set CYDEV_CHIP_MEMBER_4G, 4
.set CYDEV_CHIP_MEMBER_4H, 17
.set CYDEV_CHIP_MEMBER_4I, 23
.set CYDEV_CHIP_MEMBER_4J, 14
.set CYDEV_CHIP_MEMBER_4K, 15
.set CYDEV_CHIP_MEMBER_4L, 22
.set CYDEV_CHIP_MEMBER_4M, 21
.set CYDEV_CHIP_MEMBER_4N, 10
.set CYDEV_CHIP_MEMBER_4O, 7
.set CYDEV_CHIP_MEMBER_4P, 20
.set CYDEV_CHIP_MEMBER_4Q, 12
.set CYDEV_CHIP_MEMBER_4R, 8
.set CYDEV_CHIP_MEMBER_4S, 11
.set CYDEV_CHIP_MEMBER_4T, 9
.set CYDEV_CHIP_MEMBER_4U, 5
.set CYDEV_CHIP_MEMBER_4V, 16
.set CYDEV_CHIP_MEMBER_5A, 3
.set CYDEV_CHIP_MEMBER_5B, 2
.set CYDEV_CHIP_MEMBER_6A, 24
.set CYDEV_CHIP_MEMBER_FM3, 28
.set CYDEV_CHIP_MEMBER_FM4, 29
.set CYDEV_CHIP_MEMBER_PDL_FM0P_TYPE1, 25
.set CYDEV_CHIP_MEMBER_PDL_FM0P_TYPE2, 26
.set CYDEV_CHIP_MEMBER_PDL_FM0P_TYPE3, 27
.set CYDEV_CHIP_MEMBER_UNKNOWN, 0
.set CYDEV_CHIP_MEMBER_USED, CYDEV_CHIP_MEMBER_5B
.set CYDEV_CHIP_DIE_EXPECT, CYDEV_CHIP_MEMBER_USED
.set CYDEV_CHIP_DIE_ACTUAL, CYDEV_CHIP_DIE_EXPECT
.set CYDEV_CHIP_REV_LEOPARD_ES1, 0
.set CYDEV_CHIP_REV_LEOPARD_ES2, 1
.set CYDEV_CHIP_REV_LEOPARD_ES3, 3
.set CYDEV_CHIP_REV_LEOPARD_PRODUCTION, 3
.set CYDEV_CHIP_REV_PSOC4A_ES0, 17
.set CYDEV_CHIP_REV_PSOC4A_PRODUCTION, 17
.set CYDEV_CHIP_REV_PSOC5LP_ES0, 0
.set CYDEV_CHIP_REV_PSOC5LP_PRODUCTION, 0
.set CYDEV_CHIP_REV_PSOC5TM_ES0, 0
.set CYDEV_CHIP_REV_PSOC5TM_ES1, 1
.set CYDEV_CHIP_REV_PSOC5TM_PRODUCTION, 1
.set CYDEV_CHIP_REV_TMA4_ES, 17
.set CYDEV_CHIP_REV_TMA4_ES2, 33
.set CYDEV_CHIP_REV_TMA4_PRODUCTION, 17
.set CYDEV_CHIP_REVISION_3A_ES1, 0
.set CYDEV_CHIP_REVISION_3A_ES2, 1
.set CYDEV_CHIP_REVISION_3A_ES3, 3
.set CYDEV_CHIP_REVISION_3A_PRODUCTION, 3
.set CYDEV_CHIP_REVISION_4A_ES0, 17
.set CYDEV_CHIP_REVISION_4A_PRODUCTION, 17
.set CYDEV_CHIP_REVISION_4D_PRODUCTION, 0
.set CYDEV_CHIP_REVISION_4E_CCG2_NO_USBPD, 0
.set CYDEV_CHIP_REVISION_4E_PRODUCTION, 0
.set CYDEV_CHIP_REVISION_4F_PRODUCTION, 0
.set CYDEV_CHIP_REVISION_4F_PRODUCTION_256DMA, 0
.set CYDEV_CHIP_REVISION_4F_PRODUCTION_256K, 0
.set CYDEV_CHIP_REVISION_4G_ES, 17
.set CYDEV_CHIP_REVISION_4G_ES2, 33
.set CYDEV_CHIP_REVISION_4G_PRODUCTION, 17
.set CYDEV_CHIP_REVISION_4H_PRODUCTION, 0
.set CYDEV_CHIP_REVISION_4I_PRODUCTION, 0
.set CYDEV_CHIP_REVISION_4J_PRODUCTION, 0
.set CYDEV_CHIP_REVISION_4K_PRODUCTION, 0
.set CYDEV_CHIP_REVISION_4L_PRODUCTION, 0
.set CYDEV_CHIP_REVISION_4M_PRODUCTION, 0
.set CYDEV_CHIP_REVISION_4N_PRODUCTION, 0
.set CYDEV_CHIP_REVISION_4O_PRODUCTION, 0
.set CYDEV_CHIP_REVISION_4P_PRODUCTION, 0
.set CYDEV_CHIP_REVISION_4Q_PRODUCTION, 0
.set CYDEV_CHIP_REVISION_4R_PRODUCTION, 0
.set CYDEV_CHIP_REVISION_4S_PRODUCTION, 0
.set CYDEV_CHIP_REVISION_4T_PRODUCTION, 0
.set CYDEV_CHIP_REVISION_4U_PRODUCTION, 0
.set CYDEV_CHIP_REVISION_4V_PRODUCTION, 0
.set CYDEV_CHIP_REVISION_5A_ES0, 0
.set CYDEV_CHIP_REVISION_5A_ES1, 1
.set CYDEV_CHIP_REVISION_5A_PRODUCTION, 1
.set CYDEV_CHIP_REVISION_5B_ES0, 0
.set CYDEV_CHIP_REVISION_5B_PRODUCTION, 0
.set CYDEV_CHIP_REVISION_6A_ES, 17
.set CYDEV_CHIP_REVISION_6A_NO_UDB, 33
.set CYDEV_CHIP_REVISION_6A_PRODUCTION, 33
.set CYDEV_CHIP_REVISION_FM3_PRODUCTION, 0
.set CYDEV_CHIP_REVISION_FM4_PRODUCTION, 0
.set CYDEV_CHIP_REVISION_PDL_FM0P_TYPE1_PRODUCTION, 0
.set CYDEV_CHIP_REVISION_PDL_FM0P_TYPE2_PRODUCTION, 0
.set CYDEV_CHIP_REVISION_PDL_FM0P_TYPE3_PRODUCTION, 0
.set CYDEV_CHIP_REVISION_USED, CYDEV_CHIP_REVISION_5B_PRODUCTION
.set CYDEV_CHIP_REV_EXPECT, CYDEV_CHIP_REVISION_USED
.set CYDEV_CONFIG_FASTBOOT_ENABLED, 1
.set CYDEV_CONFIG_UNUSED_IO_AllowButWarn, 0
.set CYDEV_CONFIG_UNUSED_IO, CYDEV_CONFIG_UNUSED_IO_AllowButWarn
.set CYDEV_CONFIG_UNUSED_IO_AllowWithInfo, 1
.set CYDEV_CONFIG_UNUSED_IO_Disallowed, 2
.set CYDEV_CONFIGURATION_COMPRESSED, 1
.set CYDEV_CONFIGURATION_DMA, 0
.set CYDEV_CONFIGURATION_ECC, 1
.set CYDEV_CONFIGURATION_IMOENABLED, CYDEV_CONFIG_FASTBOOT_ENABLED
.set CYDEV_CONFIGURATION_MODE_COMPRESSED, 0
.set CYDEV_CONFIGURATION_MODE, CYDEV_CONFIGURATION_MODE_COMPRESSED
.set CYDEV_CONFIGURATION_MODE_DMA, 2
.set CYDEV_CONFIGURATION_MODE_UNCOMPRESSED, 1
.set CYDEV_DEBUG_ENABLE_MASK, 0x20
.set CYDEV_DEBUG_ENABLE_REGISTER, CYREG_MLOGIC_DEBUG
.set CYDEV_DEBUGGING_DPS_Disable, 3
.set CYDEV_DEBUGGING_DPS_JTAG_4, 1
.set CYDEV_DEBUGGING_DPS_JTAG_5, 0
.set CYDEV_DEBUGGING_DPS_SWD, 2
.set CYDEV_DEBUGGING_DPS_SWD_SWV, 6
.set CYDEV_DEBUGGING_DPS, CYDEV_DEBUGGING_DPS_SWD_SWV
.set CYDEV_DEBUGGING_ENABLE, 1
.set CYDEV_DEBUGGING_XRES, 0
.set CYDEV_DMA_CHANNELS_AVAILABLE, 24
.set CYDEV_ECC_ENABLE, 0
.set CYDEV_HEAP_SIZE, 0x80
.set CYDEV_INSTRUCT_CACHE_ENABLED, 1
.set CYDEV_INTR_RISING, 0x00000000
.set CYDEV_IS_EXPORTING_CODE, 0
.set CYDEV_IS_IMPORTING_CODE, 0
.set CYDEV_PROJ_TYPE, 0
.set CYDEV_PROJ_TYPE_BOOTLOADER, 1
.set CYDEV_PROJ_TYPE_LAUNCHER, 5
.set CYDEV_PROJ_TYPE_LOADABLE, 2
.set CYDEV_PROJ_TYPE_LOADABLEANDBOOTLOADER, 4
.set CYDEV_PROJ_TYPE_MULTIAPPBOOTLOADER, 3
.set CYDEV_PROJ_TYPE_STANDARD, 0
.set CYDEV_PROTECTION_ENABLE, 0
.set CYDEV_STACK_SIZE, 0x0800
.set CYDEV_USB_CLK_OSC_LOCKING_ENABLED_AT_PWR_UP, 1
.set CYDEV_USE_BUNDLED_CMSIS, 1
.set CYDEV_VARIABLE_VDDA, 0
.set CYDEV_VDDA_MV, 5000
.set CYDEV_VDDD_MV, 5000
.set CYDEV_VDDIO0_MV, 5000
.set CYDEV_VDDIO1_MV, 5000
.set CYDEV_VDDIO2_MV, 5000
.set CYDEV_VDDIO3_MV, 5000
.set CYDEV_VIO0_MV, 5000
.set CYDEV_VIO1_MV, 5000
.set CYDEV_VIO2_MV, 5000
.set CYDEV_VIO3_MV, 5000
.set CYIPBLOCK_ARM_CM3_VERSION, 0
.set CYIPBLOCK_P3_ANAIF_VERSION, 0
.set CYIPBLOCK_P3_CAPSENSE_VERSION, 0
.set CYIPBLOCK_P3_COMP_VERSION, 0
.set CYIPBLOCK_P3_DMA_VERSION, 0
.set CYIPBLOCK_P3_DRQ_VERSION, 0
.set CYIPBLOCK_P3_EMIF_VERSION, 0
.set CYIPBLOCK_P3_I2C_VERSION, 0
.set CYIPBLOCK_P3_LCD_VERSION, 0
.set CYIPBLOCK_P3_LPF_VERSION, 0
.set CYIPBLOCK_P3_PM_VERSION, 0
.set CYIPBLOCK_P3_TIMER_VERSION, 0
.set CYIPBLOCK_P3_USB_VERSION, 0
.set CYIPBLOCK_P3_VIDAC_VERSION, 0
.set CYIPBLOCK_P3_VREF_VERSION, 0
.set CYIPBLOCK_S8_GPIO_VERSION, 0
.set CYIPBLOCK_S8_IRQ_VERSION, 0
.set CYIPBLOCK_S8_SAR_VERSION, 0
.set CYIPBLOCK_S8_SIO_VERSION, 0
.set CYIPBLOCK_S8_UDB_VERSION, 0
.set DMA_CHANNELS_USED__MASK0, 0x00000000
.set CYDEV_BOOTLOADER_ENABLE, 0
.endif
